## drivers/sunxi_flash/nand/Kconfig
```kconfig
config SUNXI_NAND
	bool "Support sunxi nand devices"
	depends on ARCH_SUNXI
	help
	  Enable support for sunxi nand devices. These provide a block-level interface which permits
	  reading, writing and (in some cases) erasing blocks.

config SUNXI_UBIFS
	bool "Support sunxi nand ubifs devices"
	depends on ARCH_SUNXI
	help
	  Enable support for sunxi nand ubifs devices. These provide a block-level interface which permits
	  reading, writing and (in some cases) erasing blocks.

config SUNXI_COMM_NAND
	bool "Support COMM NAND interface"
	depends on SUNXI_NAND
	default y if MACH_SUN50IW3

config SUNXI_NAND_ERASE_ALL_BLOCK
	bool "Support NAND force erase all block interface"
	depends on SUNXI_NAND
	default n
	help
	  Enable support for sunxi nand devices.
	  These provide a all-block-erase interface which nand flash has
	  sunxi-nand-boot-crc information and occurs to oob inconsistency on the logic code.
	  note:This interface will erase all data on flash,
	  so it is recommended to use it only in debugging stage

config SUNXI_COMM_NAND_V1
	bool "Support COMM NAND V1 interface"
	depends on SUNXI_NAND || SUNXI_UBIFS
	default y if MACH_SUN8IW18 || MACH_SUN50IW5 || MACH_SUN50IW9 || MACH_SUN50IW10 || MACH_SUN8IW15 || MACH_SUN8IW7
	select SUNXI_DMA

config SUNXI_SLCNAND_OFFLINE_BURN_SECURE_FIRMWARE
	bool "Enable SUNXI SLCNAND REPLACE SPECIAL BOOT0 WITH TOC0 while OFFLINE BURN SECURITY FIRMWARE"
	depends on SUNXI_COMM_NAND_V1
	default n
	help
	  if offline burn slc rawnand, for security firmware,
	  need to backup secure boot0 in special boot0 place
```

## drivers/sunxi_flash/spinor/Kconfig
```kconfig
config SUNXI_SPINOR
	bool "Support sunxi spinor devices"
	depends on SUNXI_FLASH
	default y if SPI_FLASH
	help
	  Enable support for sunxi spinor devices. These provide a block-level interface which permits
	  reading, writing and (in some cases) erasing blocks.

if SUNXI_SPINOR
config SPINOR_LOGICAL_OFFSET
	int "logic address for read/write"
	default 2016
	help
	  logic address for mbr and partitions(1M-MBRSIZE = 2048-32).
	  spinor address is offset*512 bytes.

config SPINOR_UBOOT_OFFSET
	int "uboot offset for boot from spinor"
	default 128
	help
	 spinor address is offset*512 bytes.

config SPINOR_LOGICAL_SECURE_OFFSET
	int "logic address for read/write"
	default 2016
	help
	  logic address for mbr and partitions(1M-MBRSIZE = 2048-32).
	  spinor address is offset*512 bytes.

config SPINOR_UBOOT_SECURE_OFFSET
	int "uboot offset for boot from spinor"
	default 128
	help
	 spinor address is offset*512 bytes.
endif
```

## drivers/sunxi_ir/Kconfig
```kconfig
menuconfig SUNXI_IR
	bool "sunxi ir"
	default n
	imply SUNXI_IR_NEC_DECODE

if SUNXI_IR

config SUNXI_IR_NEC_DECODE
	bool "support ir nec protocal"

endif
```

## drivers/sunxi_power/Kconfig
```kconfig
menuconfig SUNXI_POWER
	bool "Sunxi power device support"
if SUNXI_POWER

config SUNXI_PMU
	bool "Sunxi pmu support"
	---help---
	Select this to enable support for PMU
config SUNXI_BMU
	bool "Sunxi bmu support"
	---help---
	Select this to enable support for BMU
config SUNXI_TRY_POWER_SPLY
	bool "try power sply"
	depends on SUNXI_PMU
	---help---
	Try to find for example axp806_power_sply

config AXPNULL_POWER
	bool "axpdummy support board without a pmic"
	depends on SUNXI_PMU
	---help---
	Select this for boards which do not use a PMIC.

config AXP858_POWER
	bool "pmu axp858 pmic support"
	depends on SUNXI_PMU
	select AXP_PMIC_BUS
	select CMD_POWEROFF
	---help---
	Say y here to enable support for the axp858 pmic found on some
	A50 PMU dev board

config AXP2585_POWER
	bool "bmu axp2585 pmic support"
	depends on SUNXI_BMU
	select AXP_PMIC_BUS
	select CMD_POWEROFF
	---help---
	Say y here to enable support for the axp2585 pmic found on some
	A50 BMU dev board

config AXP2101_POWER
	bool "pmu/bmu axp2101 pmic support"
	depends on SUNXI_PMU
	select AXP_PMIC_BUS
	select CMD_POWEROFF
	---help---
	Say y here to enable support for the axp21 pmic found on some
	sun8iw19p1 PMU/BMU dev board

config AXP2202_POWER
	bool "pmu/bmu axp2202 pmic support"
	depends on SUNXI_PMU
	select AXP_PMIC_BUS
	select CMD_POWEROFF
	---help---
	Say y here to enable support for the axp2202 pmic found on some
	sun50iw10p1 PMU/BMU dev board

config SUNXI_AXP152_POWER
	bool "pmu axp152 pmic support"
	depends on SUNXI_PMU
	select AXP_PMIC_BUS
	select CMD_POWEROFF
	---help---
	Say y here to enable support for the axp152 pmic found on some
	sun50iw9p1 PMU dev board

config AXP1530_POWER
	bool "pmu axp1530 pmic support"
	depends on SUNXI_PMU
	select AXP_PMIC_BUS
	select CMD_POWEROFF
	---help---
	Say y here to enable support for the axp1530 pmic found on some
	sun50iw9p1 PMU dev board

config AXP81X_POWER
	bool "pmu axp81X pmic support"
	depends on SUNXI_PMU
	select AXP_PMIC_BUS
	select CMD_POWEROFF
	---help---
	Say y here to enable support for the axp81X pmic found on some
	sun50iw10p1 PMU/PMU dev board

config AXP806_POWER
	bool "pmu axp806 pmic support"
	depends on SUNXI_PMU
	select AXP_PMIC_BUS
	select CMD_POWEROFF
	---help---
	Say y here to enable support for the axp81X pmic found on some
	sun50iw9p1 PMU dev board

config AXP221_POWER_SUNXI
	bool "pmu axp221 pmic support"
	depends on SUNXI_PMU
	select AXP_PMIC_BUS
	select CMD_POWEROFF
	---help---
	Say y here to enable support for the axp221 pmic found on some
	sun8iw11p1 PMU dev board

config SUNXI_UBOOT_POWER_OFF
	bool "Sunxi uboot power off"
	---help---
	Select this to enable support for uboot power off

endif
```

## drivers/sunxi_usb/Kconfig
```kconfig
menuconfig SUNXI_USB
	bool "Sunxi usb divice support"

if SUNXI_USB

config SUNXI_EFEX
	bool "Support sunxi efex devices"
	select SUNXI_FLASH
	help
	  Enable support for sunxi efex devices. 

config SUNXI_BURN
	bool "Support sunxi uburn devices"
	select SUNXI_FLASH
	help
	  ENable support for sunxi uburn devices.

menuconfig SUNXI_FASTBOOT
	bool "Support sunxi fastboot devices"
	select SUNXI_FLASH
	imply  SUNXI_FASTBOOT_MBR
	imply  SUNXI_FASTBOOT_BOOT0
	imply  SUNXI_FASTBOOT_UBOOT
	help
	  ENable support for sunxi fastboot devices.
if SUNXI_FASTBOOT

config SUNXI_FASTBOOT_MBR
	bool "Burn MBR via fastboot"
	help
		Support use fastboot to burn MBR

config SUNXI_FASTBOOT_BOOT0
	bool "Burn boot0/toc0 via fastboot"
	help
		Support use fastboot to burn boot0/toc0

config SUNXI_FASTBOOT_UBOOT
	bool "Burn uboot0/toc1 via fastboot"
	help
		Support use fastboot to burn uboot/toc1
endif

config SUNXI_USB_DETECT
	bool "Support sunxi usb detect"
	help
		Enable support for sunxi usb detect.

endif
```

## drivers/video/soph/Kconfig
```kconfig
#
# Video drivers selection for soph soc.
#
# Author: yu.yang <yu.yang@sophgo.com>
#

menuconfig VIDEO_SOPH
	bool "Enable Sophon Video Support"
	select DM_VIDEO
	select DISPLAY
	help
	  Sophon SoCs provide video output capabilities for High-Definition
	  Multimedia Interface (HDMI), Low-voltage Differential Signalling
	  (LVDS) and Display Serial Interface (DSI).

config LOGO_FROM_INTERNEL
	bool "Use Internel Logo"
	depends on VIDEO_SOPH
	help
	  This enables use logo picture from soph_logo.h, not from emmc/spinand/spinor.

if VIDEO_SOPH

choice
	prompt "Display port selection"
	depends on VIDEO_SOPH
	help
	  Select one kind of display port or function.

config DISPLAY_SOPH_HDMI
	bool "HDMI port"
	depends on VIDEO_SOPH
	help
	  This enables High-Definition Multimedia Interface display support.

endchoice

endif
```

## drivers/video/starfive/Kconfig
```kconfig
#
# Video drivers selection for rockchip soc. These configs only impact the
# compile process. You can surely check all the options. In this case, all the
# display driver will be compiled, but which drivers finally  will be used is
# decided by device tree configuration. What's more, enable needed power for
# display by configure the device tree, and the vop driver will do the rest.
#
# Author: Eric Gao <eric.gao@rock-chips.com>
#

menuconfig VIDEO_STARFIVE
	bool "Enable STARFIVE Video Support"
	depends on DM_VIDEO
	help
	  STARFIVE SoCs provide video output capabilities for High-Definition
	  Multimedia Interface (HDMI), Low-voltage Differential Signalling
	  (LVDS), embedded DisplayPort (eDP) and Display Serial Interface (DSI).

	  This driver supports the on-chip video output device, and targets the
	  STARFIVE RK3288 and RK3399.

config VIDEO_STARFIVE_MAX_XRES
        int "Maximum horizontal resolution (for memory allocation purposes)"
	depends on VIDEO_STARFIVE
	default 3840 if DISPLAY_STARFIVE_HDMI
	default 1920
	help
	  The maximum horizontal resolution to support for the framebuffer.
	  This configuration is used for reserving/allocating memory for the
	  framebuffer during device-model binding/probing.

config VIDEO_STARFIVE_MAX_YRES
        int "Maximum vertical resolution (for memory allocation purposes)"
	depends on VIDEO_STARFIVE
	default 2160 if DISPLAY_STARFIVE_HDMI
	default 1080
	help
	  The maximum vertical resolution to support for the framebuffer.
	  This configuration is used for reserving/allocating memory for the
	  framebuffer during device-model binding/probing.

if VIDEO_STARFIVE

config DISPLAY_STARFIVE_EDP
	bool "EDP Port"
	depends on VIDEO_STARFIVE
	help
	  This enables Embedded DisplayPort(EDP) display support.

config DISPLAY_STARFIVE_LVDS
	bool "LVDS Port"
	depends on VIDEO_STARFIVE
	help
	  This enables Low-voltage Differential Signaling(LVDS) display
	  support.

config DISPLAY_STARFIVE_HDMI
	bool "HDMI port"
	select VIDEO_DW_HDMI
	depends on VIDEO_STARFIVE
	help
	  This enables High-Definition Multimedia Interface display support.

config DISPLAY_STARFIVE_MIPI
	bool "MIPI Port"
	depends on VIDEO_STARFIVE
	help
	  This enables Mobile Industry Processor Interface(MIPI) display
	  support. The mipi controller and dphy on rk3288& rk3399 support
	  16,18, 24 bits per pixel with up to 2k resolution ratio.

config VIDEO_NW_MIPI_DSI
	bool "DSI host"
	select VIDEO_MIPI_DSI
	help
	  Enables the common driver code for the Northwest
	  MIPI DSI block found in SoCs from various vendors.
	  As this does not provide any functionality by itself (but
	  rather requires a SoC-specific glue driver to call it), it
	  can not be enabled from the configuration menu.
endif
```
