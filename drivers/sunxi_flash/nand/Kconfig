## drivers/video/sunxi/Kconfig
```kconfig
#
# Video drivers selection for sunxi soc. These configs only impact the
# compile process. You can surely check all the options. In this case, all the
# display driver will be compiled, but which drivers finally  will be used is
# decided by device tree configuration. What's more, enable needed power for
# display by configure the device tree, and the vop driver will do the rest.
#
# Author: zhengxiaobin <zhengxiaobin@allwinnertech.com>
#

menu "BOOT GUI"

config BOOT_GUI
    bool "Boot GUI framework for sunxi display"
    depends on DISP2_SUNXI
    default n
    ---help---
      Boot GUI framework for sunxi display

config UPDATE_DISPLAY_MODE
	bool "Update init_disp to kernel"
	depends on BOOT_GUI
	default n
	---help---
	  Update init_disp to kernel

config CONFIG_LCD_CHECK_SKIP_OPEN
	bool "Skip LCD open in uboot"
	depends on BOOT_GUI
	default y
	---help---
	  if true, uboot will skip LCD open according ban_bl.fex in Reserve0 partition

config BOOT_GUI_DOUBLE_BUF
	bool "Enable double buffer for boot GUI"
	depends on BOOT_GUI
	default n
	---help---
	  if ture, enable double buffer for boot GUI


menuconfig BOOT_GUI_TEST
	bool "Boot GUI test command for boot gui"
	depends on BOOT_GUI
	default n
	---help---
	  Boot GUI test command

config SURPORT_DRAW_CHARS
	bool "Boot GUI test command(draw char) "
	depends on BOOT_GUI_TEST
	default y
	---help---
	  Boot GUI test command(draw char)


config SUPORT_DRAW_GEOMETRY
	bool "Boot GUI test command(draw geometry) "
	depends on BOOT_GUI_TEST
	default y
	---help---
	  Boot GUI test command(draw geometry)

endmenu

menu "SUNXI LOGO DISPLAY"
config CMD_SUNXI_BMP
	bool "Sunxi Bmp display interface"
	depends on (BOOT_GUI && SUNXI_FLASH && CMD_FAT)
	default n
	---help---
	  Load bmp from flash and display

config SUNXI_SPINOR_BMP
	bool "Bmp read interface for spinor"
	depends on (SUNXI_FLASH)
	default n
	---help---
	  Bmp read interface for spinor.Load bmp from spino into memory

config ENABLE_ADVERT_PICTURE
	bool "Change bmp logo dynamic for advert"
	depends on (CMD_SUNXI_BMP)
	default n
	---help---
	  Change bmp logo dynamic for advert

config SUNXI_SPINOR_JPEG
	bool "jpeg read interface for spinor"
	depends on (SUNXI_FLASH)
	default n
	---help---
	  jpeg read interface for spinor.Load jpeg from spino into memory

config CMD_SUNXI_JPEG
	bool "Sunxi JPEG display interface"
	depends on (SUNXI_FLASH)
	default y if SUNXI_SPINOR_JPEG
	---help---
	  Load bmp from flash and display
endmenu


menuconfig DISP2_SUNXI
	bool "DISP Driver Support(sunxi-disp2)"
	depends on (ARCH_SUNXI)
	select CLK_SUNXI
	default n
	---help---
	  Display driver for sunxi based boards.


config HDMI_DISP2_SUNXI
	bool "HDMI-1.4 Driver Support(sunxi-disp2)"
	depends on (DISP2_SUNXI)
	default n
	---help---
	  Hdmi-1.4 driver for sunxi based boards.

menuconfig HDMI2_DISP2_SUNXI
  bool "HDMI2.0 Driver Support(sunxi-disp2)"
  depends on (DISP2_SUNXI)
  default n
  ---help---
  Say Y here if you want to have support for HDMI2.0 controller
  on the sunxi based boards. The HDMI2.0 controller include edid,
  hdcp1.4,hdcp2.2,cec feature and is compatible with hdmi1.4,support
  HDR,4k@60Hz. If unsure, say N.

choice
	prompt "HDMI2.0 PHY SELECT."
config DEFAULT_PHY
	bool "Synopsys PHY"
	depends on HDMI2_DISP2_SUNXI
	help
	Use original phy to show
config AW_PHY
	bool "Allwinner PHY"
	depends on HDMI2_DISP2_SUNXI
	help
	Use sunxi self phy to show
endchoice



menuconfig HDMI2_HDCP_SUNXI
  bool "HDMI2.0 HDCP"
  depends on (HDMI2_DISP2_SUNXI)
  default n
  ---help---
  Say Y here if you want to handle the cec message by User Space.
  Say N here if you want to handle the cec message by Kernel.
  If unsure, say N.

config HDMI2_HDCP22_SUNXI
  bool "HDMI2.0 HDCP2.2"
  depends on (HDMI2_HDCP_SUNXI && HDMI2_DISP2_SUNXI)
  default n
  ---help---
  Say Y here if you want to handle the cec message by User Space.
  Say N here if you want to handle the cec message by Kernel.
  If unsure, say N.

menuconfig HDMI2_CEC_SUNXI
  bool "HDMI2.0 CEC"
  depends on (HDMI2_DISP2_SUNXI)
  default n
  ---help---
  Say Y here if you want to handle the cec message by User Space.
  Say N here if you want to handle the cec message by Kernel.
  If unsure, say N.

config HDMI2_CEC_USER
  bool "HDMI2.0 CEC handled by user space"
  depends on (HDMI2_CEC_SUNXI && HDMI2_DISP2_SUNXI)
  default n
  ---help---
  Say Y here if you want to handle the cec message by User Space.
  Say N here if you want to handle the cec message by Kernel.
  If unsure, say N.

config HDMI2_FREQ_SPREAD_SPECTRUM
  bool "new frequency spread spectrum(hershey) of sunxi"
  depends on HDMI2_DISP2_SUNXI
  default n
  ---help---
  Say Y here if you want to use new frequency spread spectrum(hershey) of sunxi.
  Say N here if you do NOT want to new frequency spread spectrum of sunxi.
  If unsure, say N

config VDPO_DISP2_SUNXI
	 bool "VDPO Driver Support(sunxi-disp2)"
	 depends on (DISP2_SUNXI)
	 default n
	 ---help---
	  VDPO(bt656 and bt1120 output) driver for sunxi based boards.

menuconfig TV_DISP2_SUNXI
    bool "TV Driver Support(sunxi-disp2)"
    depends on (DISP2_SUNXI)
    default n
    ---help---
    TV driver for sunxi based boards.ie. CVBS out, VGA out, YPbPr out
    And GM7121 and ac200.

config DISP2_TV_GM7121
	bool "GM7121 TV module Support(sunxi-disp2)"
 	depends on (DISP2_SUNXI && TV_DISP2_SUNXI)
	default n
	---help---

config DISP2_TV_AC200
	bool "AC200 TV module Support(sunxi-disp2)"
	depends on (DISP2_SUNXI && TV_DISP2_SUNXI)
	default n
	---help---

config EDP_DISP2_SUNXI
	bool "EDP Driver Support(sunxi-disp2)"
	depends on (DISP2_SUNXI)
	default n
	---help---
      EDP 1.2 driver for sunxi. Embedded Display Port is
      a high speed display interface for embedded device.
      DisplayPort can be used to transmit audio and video
      simultaneously, but each one is optional and can be
      transmitted without the other.


config EINK_PANEL_USED
	bool "Eink panel used"
	depends on (DISP2_SUNXI && CONFIG_MACH_SUN8IW15)
	default n
	---help---

config EINK200_SUNXI
	bool "Eink Driver Version 2.0 Support"
	depends on (ARCH_SUNXI)
	default n
	---help---

menu "LCD panels select"
	depends on DISP2_SUNXI

source "drivers/video/sunxi/disp2/disp/lcd/Kconfig"
endmenu

menu "Display engine feature select"
	depends on DISP2_SUNXI

source "drivers/video/sunxi/disp2/disp/Kconfig"
endmenu

config SUNXI_TV_FASTLOGO
	bool "SUNXI_TV_FASTLOGO"
	depends on (SUNXI_FLASH)
	imply SUNXI_ARM_SOFT_FP
	default n
	---help---
	  fastlogo

config SUNXI_FASTLOGO_JPEG
	bool "SUNXI_FASTLOGO_JPEG"
	depends on (SUNXI_FLASH)
	default n
	---help---
	  fastlogo jepg decode support
```

## drivers/video/sunxi/disp2/disp/lcd/Kconfig
```kconfig
config LCD_SUPPORT_GG1P4062UTSW
	bool "LCD support cpu_gg1p4062utsw panel"
	default n
	---help---
		If you want to support cpu_gg1p4062utsw panel for display driver, select it.

config LCD_SUPPORT_DX0960BE40A1
	bool "LCD support dx0960be40a1 panel"
	default n
	---help---
		If you want to support dx0960be40a1 panel for display driver, select it.

config LCD_SUPPORT_TFT720X1280
	bool "LCD support dx0960be40a1 panel"
	default n
	---help---
		If you want to support dx0960be40a1 panel for display driver, select it.

config LCD_SUPPORT_FD055HD003S
	bool "LCD support fd055hd003s panel"
	default n
	---help---
		If you want to support fd055hd003s panel for display driver, select it.

config LCD_SUPPORT_HE0801A068
	bool "LCD support he0801a068 panel"
	default y
	---help---
		If you want to support he0801a068 panel for display driver, select it.

config LCD_SUPPORT_ILI9341
	bool "LCD support ili9341 panel"
	default n
	---help---
		If you want to support ili9341 panel for display driver, select it.

config LCD_SUPPORT_LH219WQ1
	bool "LCD support LH219WQ1 panel"
	default n
	---help---
		If you want to support LH219WQ1 panel for display driver, select it.

config LCD_SUPPORT_LS029B3SX02
	bool "LCD support ls029b3sx02 panel"
	default n
	---help---
		If you want to support ls029b3sx02 panel for display driver, select it.

config LCD_SUPPORT_LT070ME05000
	bool "LCD support lt070me05000 panel"
	default n
	---help---
		If you want to support lt070me05000 panel for display driver, select it.


config LCD_SUPPORT_S6D7AA0X01
	bool "LCD support S6D7AA0X01 panel"
	default n
	---help---
		If you want to support S6D7AA0X01 panel for display driver, select it.


config LCD_SUPPORT_T27P06
	bool "LCD support t27p06 panel"
	default n
	---help---
		If you want to support t27p06 panel for display driver, select it.

config LCD_SUPPORT_TFT720x1280
	bool "LCD support tft720x1280 panel"
	default n
	---help---
		If you want to support tft720x1280 panel for display driver, select it.


config LCD_SUPPORT_WTQ05027D01
	bool "LCD support wtq05027d01 panel"
	default n
	---help---
		If you want to support wtq05027d01 panel for display driver, select it.

config LCD_SUPPORT_H245QBN02
	bool "LCD support H245QBN02 panel"
	default n
	---help---
		If you want to support H245QBN02 panel for display driver, select it.

config LCD_SUPPORT_ST7789V
	bool "LCD support ST7789V panel"
	default n
	---help---
		If you want to support ST7789V panel for display driver, select it.

config LCD_SUPPORT_ST7796S
	bool "LCD support ST7796S panel"
	default n
	---help---
		If you want to support ST7796S panel for display driver, select it.

config LCD_SUPPORT_ST7701S
	bool "LCD support ST7701S panel"
	default n
	---help---
		If you want to support ST7701S panel for display driver, select it.

config LCD_SUPPORT_T30P106
	bool "LCD support T30P106 panel"
	default n
	---help---
		If you want to support T30P106 panel for display driver, select it.

config LCD_SUPPORT_TO20T20000
	bool "LCD support TO20T20000 panel"
	default n
	---help---
		If you want to support TO20T20000 panel for display driver, select it.

config LCD_SUPPORT_FRD450H40014
	bool "LCD support FRD450H40014 panel"
	default n
	---help---
		If you want to support FRD450H40014 panel for display driver, select it.

config LCD_SUPPORT_S2003T46G
	bool "LCD support S2003T46G panel"
	default n
	---help---
		If you want to support S2003T46G panel for display driver, select it.

config LCD_SUPPORT_WILLIAMLCD
	bool "LCD support WilliamLcd panel"
	default y
	---help---
		If you want to support WilliamLcd panel for display driver, select it.

config LCD_SUPPORT_LQ101R1SX03
	bool "LCD support lq101r1sx03 panel"
	default y
	---help---
		If you want to support lq101r1sx03 panel for display driver, select it.

config LCD_SUPPORT_INET_DSI_PANEL
	bool "LCD support inet_dsi_panel panel"
	default y
	---help---
		If you want to support inet_dsi_panel panel for display driver, select it.

config LCD_SUPPORT_WTL096601G03
	bool "LCD support WTL096601G03 panel"
	default n
	---help---
		If you want to support WTL096601G03 panel for display driver, select it.

config LCD_SUPPORT_BP101WX1
	bool "LCD support BP101WX1 panel"
	default n
	---help---
		If you want to support BP101WX1 panel for display driver, select it.

config LCD_SUPPORT_M133X56
	bool "LCD support M133X56 panel"
	default n
	---help---
		If you want to support M133X56 panel for display driver, select it.

config LCD_SUPPORT_K101IM2QA04
	bool "LCD support K101IM2QA04 panel"
	default n
	---help---
		If you want to support K101IM2QA04 panel for display driver, select it.

config LCD_SUPPORT_K101_MM2QA01_A
	bool "LCD support K101_MM2QA01_A panel"
	default n
	---help---
		If you want to support K101_MM2QA01_A panel for display driver, select it.

config LCD_SUPPORT_K101IM2BYL02L
	bool "LCD support K101IM2BYL02L"
	default n
	---help---
		If you want to support K101IM2BYL02L panel for display driver, select it.

config LCD_SUPPORT_FX070
	bool "LCD support fx070 panel"
	default n
	---help---
		If you want to support fx070 panel for display driver, select it.

config LCD_SUPPORT_M101B31
	bool "LCD support m101b31 panel"
	default n
	help
		If you want to support m101b31 panel for display driver, select it.

config LCD_SUPPORT_CC08021801_310_800X1280
	bool "LCD support CC08021801_310_800X1280 panel"
	default y
	---help---
		If you want to support CC08021801_310_800X1280 panel for display driver, select it.

config LCD_SUPPORT_KD101NA5
	bool "LCD support kd101na5 panel"
	default n
	---help---
		If you want to support kd101na5 panel for display driver, select it.

config LCD_SUPPORT_KD070D57
	bool "LCD support kd070d57 panel"
	default n
	---help---
		If you want to support kd070d57 panel for display driver, select it.

config LCD_SUPPORT_ZS080NI4003E7H3H_A
	bool "LCD support zs080ni4003e7h3h_a panel"
	default n
	---help---
		If you want to support zs080ni4003e7h3h_a panel for display driver, select it.

config LCD_SUPPORT_K080_IM2HYL802R_800X1280
	bool "LCD support K080_IM2HYL802R_800X1280 panel"
	default n
	---help---
		If you want to support K080_IM2HYL802R_800X1280 panel for display driver, select it.

config LCD_SUPPORT_K101_IM2BYL02_L_800X1280
	bool "LCD support K101_IM2BYL02_L_800X1280 panel"
	default n
	---help---
		if you want to support K101_IM2BYL02_L_800X1280 panel for display driver, select it.

config LCD_SUPPORT_JD9366AB_3
	bool "LCD support JD9366AB_3 panel"
	default n
	---help---
		If you want to support JD9366AB_3 panel for display driver, select it.

config LCD_SUPPORT_TFT08006
	bool "LCD support TFT08006 panel"
	default n
	---help---
		If you want to support TFT08006 panel for display driver, select it.

config LCD_SUPPORT_T050K589
	bool "LCD support T050K589 panel"
	default y
	---help---
		If you want to support T050K589 panel for display driver, select it.
```

## rtos/Kconfig
```kconfig
config SUNXI_RTOS
	bool "Sunxi Freertos support"
	default n
	help
	  Enable support for sunxi freertos

if SUNXI_RTOS
config SUNXI_RTOS_OFFSET1_ENABLE
	bool "Sunxi Freertos toc offset1 support"
	default y
	help
	  Enable freertos toc offset1

config SUNXI_RTOS_OFFSET1
	int "freertos offset 1"
	depends on SUNXI_RTOS_OFFSET1_ENABLE
	default 1024
	help
	  freertos offset1 is offset*512 bytes

config SUNXI_RTOS_OFFSET2_ENABLE
	bool "Sunxi Freertos toc offset2 support"
	default y
	help
	  Enable freertos toc offset2

config SUNXI_RTOS_OFFSET2
	int "freertos offset 2"
	depends on SUNXI_RTOS_OFFSET2_ENABLE
	default 5120
	help
	  free rtos offset2 is offset*512 bytes

config SUNXI_RTOS_LOGICAL_OFFSET
	int "freertos logical offset"
	default 10208
	help
	  spinor address is offset*512 bytes
endif
```

## sprite/Kconfig
```kconfig
menuconfig SUNXI_SPRITE
	bool "Sunxi Sprite support"
	select SUNXI_FLASH
	help
	  Enable support for sunxi efex devices. 

if SUNXI_SPRITE
config SUNXI_SECURE_STORAGE
	bool "Sunxi Sprite Secure Storage"
	help
	  Enable supprot for sunxi secure storage

config SUNXI_SPRITE_CARTOON
	bool "Sunxi Sprite cartoon support"
	select SUNXI_FLASH
	help
	  Enable support for sunxi Sprite cartoon(display)

config SUNXI_SPRITE_RECOVERY
	bool "Sunxi Sprite recovery support"
	depends on SUNXI_SDMMC
	default y
	help
	  Enable support for sunxi Sprite recovery

config SUNXI_AUTO_UPDATE
	bool "Sunxi auto update support"
	depends on MMC || USB
	default n
	help
	  Enable support for sunxi auto update
config SUNXI_DIGEST_TEST
	bool "Sunxi digest test support"
	default n
	help
	  Enable support for sunxi digest test

config SUNXI_UPDATE_GPT

	bool "Sunxi auto gpt support"
	default n
	help
	  Enable support for sunxi gpt update

choice
	depends on SUNXI_AUTO_UPDATE
	prompt "select update form sdcard or usb disk"
	default UPDATE_FROM_SDCARD

config UPDATE_FROM_SDCARD
	bool "img from sdcard"

config UPDATE_FROM_USB
	bool "img from usb disk"

endchoice
config FW_BURN_UDISK_MIN_SIZE
	hex "UDISK min data length default is 0x800"
	depends on SUNXI_SPRITE || SUNXI_AUTO_UPDATE
	default 0x800
	help
	  set UDISK min data length

config SUNXI_PART_UPDATE
	bool "Sunxi part update support"
	depends on MMC
	default n
	help
	  Enable support for sunxi auto update

endif
```
