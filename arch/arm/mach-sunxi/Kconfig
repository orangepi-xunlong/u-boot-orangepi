## board/sunxi/Kconfig
```kconfig
menu "sunxi board feature"


config SUNXI_MALLOC_LEN
	hex "sunxi_malloc_len"
	default 0x4000000
	help
		when enabled, uboot set init malloc len

config SUNXI_MAC
	bool "sunxi_mac"
	default n
	help
		when enabled, uboot read mac addr and send to system via cmdline

config SUNXI_USER_KEY
	bool "user key"
	default n
	select SUNXI_SECURE_STORAGE
	help
		when enable, uboot try to read cmdline data from secure storage

config SUNXI_FAST_BURN_KEY
	bool "sunxi fast burn key enable"
	default y
	depends on !MACH_SUN8IW18 && !MACH_SUN8IW7 && !MACH_SUN50IW3 && !MACH_SUN50IW6 && !SUNXI_UBIFS
	depends on SUNXI_BURN

config SUNXI_DRM_SUPPORT
	bool "drm support"
	default n
	help
		when enable, uboot set up drm related configurate

config SUNXI_EXTERN_SECURE_MM_LAYOUT
	bool "sunxi secure memory lay defined in fdt"
	default n
	help
		when enable, uboot try to load secure memory layout
		from fdt(shm\ta ram). Notify secure os configurated
		layout and mard those memory as "reserved memory" in
		fdt

config SUNXI_ADVERT_PICTURE
	bool "advert logo"
	default n
	depends on BOOT_GUI
	help
		when enable, uboot will try to use logo in reserve0, witch can be modified by APPS

config SUNXI_ANTI_COPY_BOARD
	bool "sunxi anti copy board"
	default n
	select SUNXI_SECURE_STORAGE
	help
		when enable, uboot will verify the board.

config SUNXI_VERIFY_DSP
	bool "sunxi verify dsp"
	default y
	depends on XTENSA_DSP
	depends on SUNXI_SECURE_BOOT
	help
		when enable, uboot will verify the dsp bin.

config SUNXI_IMAGE_HEADER
	bool "sunxi verify with image header"
	default n
	help
		when enable, uboot will verify with image header.

menuconfig SUNXI_ANDROID_BOOT
	bool "android boot sequence"
	default n
	imply SUNXI_AVB
	help
		boot seqquence requeseted by AOSP: GREEN YELLOW ORANGE RED, etc

if SUNXI_ANDROID_BOOT
config LIBAVB
	bool "android avb support lib"
	default n
	help
		library for Android verified Boot

config SUNXI_AVB
	bool "sunxi support for android verify boot"
	default n
	select LIBAVB
	help
		support android verify boot sequence in sunxi board

config SUNXI_VERIFY_BOOT_INFO_INSTALL
	bool "install verify boot info for android keymaster"
	default n
	help
		select this, uboot will store verify boot info to optee, for keymaster to read

endif

menuconfig SUNXI_CHECK_LIMIT_VERIFY
	bool "sunxi support cpu/gpu freq limit"
	default n
	help
		sunxi support cpu/gpu freq limit
if SUNXI_CHECK_LIMIT_VERIFY

config SUNXI_LIMIT_CPU_FREQ
	bool "sunxi cpu freq limit"

config SUNXI_LIMIT_GPU_FREQ
	bool "sunxi gpu freq limit"

endif

config SUNXI_MIPS
	bool "sunxi mips loading support"
	default n

config SUNXI_SWITCH_SYSTEM
	bool "Sunxi switch system"
	default n
	select BOOTCOUNT_LIMIT
	select BOOTCOUNT_ENV
	help
	    Supports automatic switching and damaged switching

config SUNXI_UPDATE_REMIND
	bool "sunxi support update remind"
	default n
	help
	    Support reminder after mass production

config SUNXI_REPLACE_FDT_FROM_PARTITION
	bool "Replace current fdt data"
	default n
	depends on OF_SEPARATE
	help
	    Get fdt data from raw partition or fat filesystem partition
	    to replace current fdt data

config SUNXI_NECESSARY_REPLACE_FDT
	bool "Replace current fdt data v2"
	default n
	depends on OF_SEPARATE
	help
	    Get fdt data from dtb.img, boot.img or vendor_boot.img
	    to replace current fdt data v2

config SUN50IW9_AUTOPRINT
	bool "Open print mode check"
	default n
	help
	    check card print and uart print,write auto_print

config SUNXI_LRADC_VOL
	bool "sunxi support lradc read voltage"
	default n
	depends on SUNXI_LRADC
	help
	    Support lradc read voltage in uboot which can be used to
	    choose sensor through different voltages.

config BOOTCMD_SKIP_MISC
	bool "sunxi skip detect misc for bootcmd"
	default n
	help

config BOOTCMD_SKIP_ADCKEY
	bool "sunxi skip detect adckey for bootcmd"
	default n
	help

config BOOTCMD_SKIP_RTC
	bool "sunxi skip detect rtc for bootcmd"
	default n
	help

menuconfig SUNXI_HOMLET
	bool "sunxi homlet support"
	default n
	help
		features for homle product

if SUNXI_HOMLET
config SUNXI_BOX_STANDBY
	bool "box standby"
	default n

config ATF_BOX_STANDBY
	bool "atf box standby"
	default n

config IR_BOOT_RECOVERY
	bool "support ir remote control"
	default n
	select SUNXI_IR

config RECOVERY_KEY
	bool "support recovery key"
	default n

config SUNXI_HDCP_IN_SECURESTORAGE
	bool "hdcp key support"
	default n
	imply SUNXI_HDCP_HASH
	help
		support hdcp key

config SUNXI_CHECK_CUSTOMER_RESERVED_ID
	bool "check customer reserved id"
	default n
	help
		support check customer reserved id
config SUNXI_CUSTOMER_RESERVED_ID_ENABLE
	bool "fill customer reserved id"
	depends on SUNXI_CHECK_CUSTOMER_RESERVED_ID
	default n
	help
		support software to write customer reserved id
config SUNXI_CUSTOMER_RESERVED_ID
	hex "set customer reserved id value"
	depends on SUNXI_CUSTOMER_RESERVED_ID_ENABLE
	default 0
	help
		set customer reserved id value

config START_MODE_RTC_REG_INDEX
	hex "homtlet/tv boot mode reg"
	default 0x2
	---help---
	specific reg stored homtlet/tv start mode flag

if SUNXI_HDCP_IN_SECURESTORAGE
config SUNXI_HDCP_HASH
	bool "hdcp key hash process"
	default n
	help
		store hdcp key hash for key usage

endif

endif

choice
	prompt "sunxi image compression type"
	default SUNXI_COMP_NONE

config SUNXI_COMP_NONE
	bool "none"
	help
		Image use none compression type

config SUNXI_COMP_GZ
	bool "gzip"
	help
		Image use gzip compression type

config SUNXI_COMP_DETECT
        bool "auto detect"
	help
		Auto detect image compression type

endchoice

choice
	prompt "rotpk burn on sprite"
	default SUNXI_NOT_BURN_ROTPK

config SUNXI_NOT_BURN_ROTPK
	bool "do not burn"

config SUNXI_BURN_ROTPK_ON_SPRITE
	bool "always burn"
	depends on SUNXI_CE_DRIVER
	help
		Burn rotpk before set secure bit to 1

config SUNXI_ROTPK_BURN_ENABLE_BY_TOOL
	bool "tool enable"
	depends on SUNXI_CE_DRIVER
	help
		if tool do not specific, do not burn

endchoice

config SUNXI_FPGA_PLATFORM
	bool "build for fpga platform"
	help
		fpga board have special treament for resources like
		clock or io, this config enable thoes special treament

config SUNXI_TRACE
	bool "enable trace feature"
	help
		trace feature based on origin TRACE
config SUNXI_MEM_INFO
        bool "sunxi memory info"
        default y
        help
           enable memory information

endmenu
```

## configs/a64-olinuxino_defconfig
```kconfig
CONFIG_ARM=y
CONFIG_ARCH_SUNXI=y
CONFIG_DEFAULT_DEVICE_TREE="sun50i-a64-olinuxino"
CONFIG_SPL=y
CONFIG_SPL_SPI_FLASH_SUPPORT=y
CONFIG_SPL_SPI_SUNXI=y
CONFIG_MACH_SUN50I=y
CONFIG_RESERVE_ALLWINNER_BOOT0_HEADER=y
CONFIG_MMC_SUNXI_SLOT_EXTRA=2
# CONFIG_SYS_MALLOC_CLEAR_ON_INIT is not set
CONFIG_DRAM_CLK=624
CONFIG_DRAM_ZQ=3881949
CONFIG_SUN8I_EMAC=y
CONFIG_USB_EHCI_HCD=y
CONFIG_USB_OHCI_HCD=y
CONFIG_VIDEO_DE2=n
```

## configs/orangepi_3_defconfig
```kconfig
CONFIG_ARM=y
CONFIG_ARCH_SUNXI=y
CONFIG_MACH_SUN50I_H6=y
CONFIG_SUNXI_DRAM_H6_LPDDR3=y
CONFIG_SUNXI_DRAM_DDR3=n
CONFIG_DRAM_ODT_EN=y
CONFIG_MMC0_CD_PIN="PF6"
CONFIG_MMC_SUNXI_SLOT_EXTRA=2
CONFIG_HDMI_DDC_EN="PH2"
# CONFIG_PSCI_RESET is not set
CONFIG_DEFAULT_DEVICE_TREE="sun50i-h6-orangepi-3"
# CONFIG_SYS_MALLOC_CLEAR_ON_INIT is not set
CONFIG_SPL=y
# CONFIG_CMD_FLASH is not set
# CONFIG_CMD_FPGA is not set
# CONFIG_SPL_DOS_PARTITION is not set
# CONFIG_SPL_ISO_PARTITION is not set
# CONFIG_SPL_EFI_PARTITION is not set
```

## configs/orangepi_zero2_b_defconfig
```kconfig
CONFIG_ARM=y
CONFIG_ARCH_SUNXI=y
CONFIG_DEFAULT_DEVICE_TREE="sun50i-h616-orangepi-zero2-b"
CONFIG_SPL=y
CONFIG_DRAM_CLK=672
CONFIG_SUNXI_DRAM_H616_LPDDR3=y
CONFIG_DRAM_SUN50I_H616_READ_CALIBRATION=y
CONFIG_DRAM_SUN50I_H616_UNKNOWN_FEATURE=y
CONFIG_DRAM_SUN50I_H616_BIT_DELAY_COMPENSATION=y
CONFIG_MACH_SUN50I_H616=y
CONFIG_MMC0_CD_PIN="PF6"
CONFIG_R_I2C_ENABLE=y
# CONFIG_SYS_MALLOC_CLEAR_ON_INIT is not set
CONFIG_SPL_I2C_SUPPORT=y
CONFIG_AXP_DCDC4_VOLT=1200
CONFIG_SUN8I_EMAC=y
CONFIG_PWRLED="PC12"
```

## configs/orangepi_zero3_defconfig
```kconfig
CONFIG_ARM=y
CONFIG_ARCH_SUNXI=y
CONFIG_DEFAULT_DEVICE_TREE="sun50i-h616-orangepi-zero3"
CONFIG_SPL=y
CONFIG_DRAM_CLK=792
CONFIG_SUNXI_DRAM_H616_LPDDR4=y
CONFIG_DRAM_SUN50I_H616_READ_CALIBRATION=y
CONFIG_DRAM_SUN50I_H616_UNKNOWN_FEATURE=y
CONFIG_DRAM_SUN50I_H616_BIT_DELAY_COMPENSATION=y
# CONFIG_DRAM_SUN50I_H616_TRIM_SIZE is not set
CONFIG_MACH_SUN50I_H616=y
CONFIG_MMC0_CD_PIN="PF6"
CONFIG_R_I2C_ENABLE=y
# CONFIG_SYS_MALLOC_CLEAR_ON_INIT is not set
CONFIG_AXP_DCDC3_VOLT=1100
CONFIG_SPL_I2C_SUPPORT=y
CONFIG_AXP313A_POWER=y
CONFIG_SPL_SPI_SUNXI=y
CONFIG_PWRLED="PC12"
```

## configs/orangepi_zero_plus2_h3_defconfig
```kconfig
CONFIG_ARM=y
CONFIG_ARCH_SUNXI=y
CONFIG_SYS_TEXT_BASE=0x4a000000
CONFIG_MACH_SUN8I_H3=y
CONFIG_DRAM_CLK=408
CONFIG_DRAM_ZQ=3881979
CONFIG_DRAM_ODT_EN=y
CONFIG_DEFAULT_DEVICE_TREE="sun8i-h3-orangepi-zero-plus2"
CONFIG_MMC_SUNXI_SLOT_EXTRA=2
# CONFIG_SYS_MALLOC_CLEAR_ON_INIT is not set
CONFIG_SPL=y
CONFIG_SPL_SPI_FLASH_SUPPORT=y
CONFIG_SPL_SPI_SUNXI=y
# CONFIG_CMD_IMLS is not set
# CONFIG_CMD_FLASH is not set
# CONFIG_CMD_FPGA is not set
# CONFIG_SPL_DOS_PARTITION is not set
# CONFIG_SPL_ISO_PARTITION is not set
# CONFIG_SPL_EFI_PARTITION is not set
CONFIG_USB_EHCI_HCD=y
```

## configs/recore_defconfig
```kconfig
CONFIG_ARM=y
CONFIG_ARCH_SUNXI=y
CONFIG_SPL=y
CONFIG_MACH_SUN50I=y
CONFIG_MMC=y
CONFIG_MMC_SUNXI_SLOT_EXTRA=2
CONFIG_RESERVE_ALLWINNER_BOOT0_HEADER=y
CONFIG_DEFAULT_DEVICE_TREE="sun50i-a64-recore"
CONFIG_OF_LIST="sun50i-a64-recore"
CONFIG_VIDEO=y
CONFIG_PHY_REALTEK=y
CONFIG_SUN8I_EMAC=y
CONFIG_USB_EHCI_HCD=y
CONFIG_USB_OHCI_HCD=y
CONFIG_ENV_IS_NOWHERE=y
#CONFIG_ENV_IS_IN_MMC=y
CONFIG_SPL_STACK=0x54000
CONFIG_SYS_PBSIZE=1024
CONFIG_SYS_BOOTM_LEN=0x2000000
CONFIG_SUPPORT_EMMC_BOOT=y
CONFIG_LED=y
CONFIG_LED_GPIO=y
CONFIG_SPLASH_SCREEN_ALIGN=y
CONFIG_VIDEO_LOGO=y
CONFIG_SPLASH_SCREEN=y
CONFIG_BMP_16BPP=y
CONFIG_BMP_24BPP=y
CONFIG_BMP_32BPP=y
CONFIG_VIDEO_BMP_RLE8=y
CONFIG_DM_REGULATOR=y
CONFIG_DM_REGULATOR_FIXED=y
CONFIG_CMD_REGULATOR=y
```

## configs/starfive_visionfive2_defconfig
```kconfig
CONFIG_RISCV=y
CONFIG_SYS_MALLOC_F_LEN=0x10000
CONFIG_NR_DRAM_BANKS=1
CONFIG_ENV_SIZE=0x10000
CONFIG_ENV_OFFSET=0xF0000
CONFIG_SPL_DM_SPI=y
CONFIG_DEFAULT_DEVICE_TREE="starfive_visionfive2"
CONFIG_SPL_MMC_SUPPORT=y
CONFIG_SPL_DRIVERS_MISC=y
CONFIG_SPL=y
CONFIG_SPL_SPI_FLASH_SUPPORT=y
CONFIG_SPL_SPI_SUPPORT=y
CONFIG_BUILD_TARGET=""
CONFIG_TARGET_STARFIVE_VISIONFIVE2=y
CONFIG_SPL_OPENSBI_LOAD_ADDR=0x40000000
CONFIG_NR_CPUS=5
CONFIG_FPGA_GMAC_SPEED_AUTO=y
CONFIG_STARFIVE_JH7110_L2CC_FLUSH=y
CONFIG_ARCH_RV64I=y
CONFIG_CMODEL_MEDANY=y
CONFIG_RISCV_SMODE=y
CONFIG_SHOW_REGS=y
CONFIG_FIT=y
CONFIG_SPL_FIT_SOURCE="jh7110-uboot-fit-image.its"
CONFIG_SUPPORT_RAW_INITRD=y
CONFIG_QSPI_BOOT=y
CONFIG_SD_BOOT=y
CONFIG_SPI_BOOT=y
CONFIG_USE_BOOTARGS=y
CONFIG_BOOTARGS="console=tty1 console=ttyS0,115200  debug rootwait  earlycon=sbi"
CONFIG_USE_BOOTCOMMAND=y
CONFIG_BOOTCOMMAND="run sdk_boot_env; run distro_boot_env"
CONFIG_USE_PREBOOT=y
CONFIG_PREBOOT="run chipa_set_uboot;"
CONFIG_DEFAULT_FDT_FILE="starfive/jh7110-visionfive-v2.dtb"
CONFIG_LOG_MAX_LEVEL=4
CONFIG_SPL_LOG=y
CONFIG_DISPLAY_CPUINFO=y
CONFIG_DISPLAY_BOARDINFO=y
CONFIG_DISPLAY_BOARDINFO_LATE=y
CONFIG_BOARD_LATE_INIT=y
CONFIG_MISC_INIT_R=y
CONFIG_ID_EEPROM=y
CONFIG_SYS_MMCSD_RAW_MODE_U_BOOT_USE_PARTITION=y
CONFIG_SYS_MMCSD_RAW_MODE_U_BOOT_PARTITION=0x2
CONFIG_SPL_I2C=y
CONFIG_SPL_DM_SPI_FLASH=y
CONFIG_SPL_DM_RESET=y
CONFIG_SPL_SPI_LOAD=y
CONFIG_HUSH_PARSER=y
CONFIG_SYS_PROMPT="StarFive # "
CONFIG_CMD_CONFIG=y
CONFIG_CMD_SBI=y
CONFIG_CMD_ERASEENV=y
CONFIG_CMD_NVEDIT_EFI=y
CONFIG_CMD_EEPROM=y
CONFIG_SYS_EEPROM_SIZE=512
CONFIG_SYS_EEPROM_PAGE_WRITE_BITS=4
CONFIG_SYS_EEPROM_PAGE_WRITE_DELAY_MS=5
CONFIG_CMD_GPT_RENAME=y
CONFIG_CMD_I2C=y
CONFIG_CMD_MISC=y
CONFIG_CMD_PART=y
CONFIG_CMD_PCI=y
CONFIG_CMD_USB=y
CONFIG_CMD_TFTPPUT=y
CONFIG_CMD_EFIDEBUG=y
CONFIG_CMD_SYSBOOT=y
CONFIG_CMD_EXT4_WRITE=y
CONFIG_CMD_FS_UUID=y
CONFIG_CMD_LOG=y
CONFIG_OF_EMBED=y
CONFIG_ENV_OVERWRITE=y
CONFIG_ENV_IS_IN_SPI_FLASH=y
CONFIG_VERSION_VARIABLE=y
CONFIG_NET_RANDOM_ETHADDR=y
CONFIG_REGMAP=y
CONFIG_SYSCON=y
CONFIG_SPL_CLK_COMPOSITE_CCF=y
CONFIG_CLK_CCF=y
CONFIG_CLK_COMPOSITE_CCF=y
CONFIG_SPL_CLK_JH7110=y
CONFIG_SYS_I2C_DW=y
CONFIG_SPL_SYS_I2C_DW=y
CONFIG_I2C_EEPROM=y
CONFIG_SPL_I2C_EEPROM=y
CONFIG_SYS_I2C_EEPROM_ADDR=0x50
CONFIG_MMC_HS200_SUPPORT=y
CONFIG_SPL_MMC_HS200_SUPPORT=y
CONFIG_MMC_DW=y
CONFIG_MMC_DW_SNPS=y
CONFIG_SF_DEFAULT_MODE=0x0
CONFIG_SF_DEFAULT_SPEED=100000000
CONFIG_SPI_FLASH_GIGADEVICE=y
CONFIG_SPI_FLASH_MACRONIX=y
CONFIG_SPI_FLASH_SPANSION=y
CONFIG_PHY_MARVELL=y
CONFIG_PHY_MICREL=y
CONFIG_PHY_MICREL_KSZ90X1=y
# CONFIG_PHY_MSCC is not set
CONFIG_PHY_YUTAI=y
CONFIG_DM_ETH_PHY=y
CONFIG_DWC_ETH_QOS=y
CONFIG_DWC_ETH_QOS_STARFIVE=y
CONFIG_RGMII=y
CONFIG_RTL8169=y
CONFIG_NVME=y
CONFIG_PCI=y
CONFIG_DM_PCI_COMPAT=y
CONFIG_PCI_REGION_MULTI_ENTRY=y
CONFIG_PINCTRL=y
CONFIG_PINCONF=y
CONFIG_PINCTRL_STARFIVE=y
CONFIG_PINCTRL_STARFIVE_JH7110=y
CONFIG_POWER_DOMAIN=y
CONFIG_STARFIVE_POWER_DOMAIN=y
CONFIG_DM_PMIC=y
CONFIG_PMIC_STARFIVE=y
CONFIG_DM_REGULATOR=y
CONFIG_DM_REGULATOR_STARFIVE=y
CONFIG_RAM=y
CONFIG_SPL_RAM=y
# CONFIG_RAM_SIFIVE is not set
CONFIG_SPL_STARFIVE_DDR=y
CONFIG_DM_RESET=y
CONFIG_SPECIFY_CONSOLE_INDEX=y
CONFIG_SYS_NS16550=y
CONFIG_SPI=y
CONFIG_CADENCE_QSPI=y
CONFIG_SYSRESET=y
CONFIG_SYSRESET_SBI=y
CONFIG_USB=y
CONFIG_USB_XHCI_HCD=y
CONFIG_USB_XHCI_PCI=y
CONFIG_USB_CDNS3=y
# CONFIG_USB_CDNS3_TI is not set
CONFIG_USB_CDNS3_STARFIVE=y
CONFIG_USB_STORAGE=y
CONFIG_DM_VIDEO=y
CONFIG_VIDEO_PCI_DEFAULT_FB_SIZE=0x8000000
CONFIG_VIDEO_COPY=y
CONFIG_VIDEO_LCD_STARFIVE_SEEED=y
CONFIG_DISPLAY=y
CONFIG_NXP_TDA19988=y
CONFIG_VIDEO_BRIDGE=y
CONFIG_VIDEO_STARFIVE=y
CONFIG_DISPLAY_STARFIVE_EDP=y
CONFIG_DISPLAY_STARFIVE_LVDS=y
CONFIG_DISPLAY_STARFIVE_HDMI=y
CONFIG_DISPLAY_STARFIVE_MIPI=y
CONFIG_VIDEO_NW_MIPI_DSI=y
CONFIG_OF_LIBFDT_OVERLAY=y
```
