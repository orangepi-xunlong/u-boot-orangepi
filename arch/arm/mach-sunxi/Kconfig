## configs/sun20iw1p1_test_defconfig
```kconfig
#arch
CONFIG_RISCV=y
CONFIG_SYS_ARCH="riscv"
CONFIG_64BIT=y
CONFIG_PHYS_64BIT=y
#CONFIG_32BIT

#CONFIG_TARGET_ARCH_SUNXI=y
CONFIG_ARCH_SUNXI=y
CONFIG_MACH_SUN20IW1=y
CONFIG_SUNXI_GPIO_V2=y

#riscv cfg
#CONFIG_ARCH_RV32I
CONFIG_ARCH_RV64I=y
CONFIG_CMODEL_MEDLOW=y
CONFIG_SUNXI_RISCV_MODE=y
#CONFIG_RISCV_MMODE=y
#CONFIG_RISCV_SMODE=y
CONFIG_RISCV_ISA_C=y
CONFIG_RISCV_ISA_A=y
CONFIG_STACK_SIZE_SHIFT=14

CONFIG_SUNXI_DMA=y

#CONFIG_AXP_GPIO=y
CONFIG_SYS_CONFIG_NAME="sun20iw1p1"
CONFIG_DEFAULT_DEVICE_TREE="sun20iw1p1-soc-system"
# CONFIG_SYS_MALLOC_CLEAR_ON_INIT is not set
CONFIG_CONSOLE_MUX=y
CONFIG_SUNXI_NECESSARY_REPLACE_FDT=y
CONFIG_RESERVE_FDT_SIZE=0x20000
CONFIG_PRE_CONSOLE_BUFFER=n
# CONFIG_OF_BOARD=y
CONFIG_OF_SEPARATE=y
CONFIG_SYS_TEXT_BASE=0x42000000
CONFIG_SUNXI_FDT_ADDR=0x41fe0000
CONFIG_SUNXI_MALLOC_LEN=0x0a00000

#Enviroment
CONFIG_ENV_IS_IN_SUNXI_FLASH=y
CONFIG_ENV_SIZE=0x20000
CONFIG_SYS_MAXARGS=64

# flash
CONFIG_SUNXI_FLASH=y
CONFIG_SUNXI_SPINOR=y
CONFIG_SUNXI_NOR_IMG=y

#SPI
CONFIG_SPI=y
CONFIG_SUNXI_SPI=y
CONFIG_SPI_USE_DMA=y
CONFIG_SPI_FLASH=y
CONFIG_SPI_FLASH_WINBOND=y
CONFIG_SPI_FLASH_EON=y
CONFIG_SPI_FLASH_GIGADEVICE=y
CONFIG_SPI_FLASH_ISSI=y
CONFIG_SPI_FLASH_MACRONIX=y
CONFIG_SPI_FLASH_SPANSION=y
CONFIG_SPI_FLASH_ATMEL=y
CONFIG_SPI_FLASH_STMICRO=y
CONFIG_SPI_FLASH_SST=y
CONFIG_SPI_FLASH_PUYA=y
CONFIG_SPI_FLASH_FM=y
CONFIG_SPI_FLASH_XT=y
CONFIG_SPI_FLASH_ADESTO=y
CONFIG_SPI_FLASH_XMC=y
CONFIG_SPI_FLASH_ZETTA=y
CONFIG_SPI_FLASH_BOYA=y

CONFIG_SF_DEFAULT_SPEED=50000000
# BIT(12) BIT(13) (SPI_RX_DUAL|SPI_RX_QUAD)
CONFIG_SF_DEFAULT_MODE=0x3000
CONFIG_SPINOR_UBOOT_OFFSET=128
CONFIG_SPINOR_LOGICAL_OFFSET=2016
#CONFIG_SPINOR_LOGICAL_OFFSET=3040
#CONFIG_SUNXI_RTOS=y
#CONFIG_SUNXI_RTOS_LOGICAL_OFFSET=96
# CONFIG_SUNXI_RTOS_OFFSET1_ENABLE is not set
#CONFIG_SUNXI_RTOS_OFFSET2_ENABLE=n

#fdt
CONFIG_CMD_FDT=y

#image
CONFIG_ANDROID_BOOT_IMAGE=y

#sprite
CONFIG_SUNXI_SPRITE=y

#pwm
CONFIG_PWM_NOT_USE=y

#smc
CONFIG_NOT_USE_OPTEE25=y

#partition
CONFIG_EFI_PARTITION=y

#usb otg config
CONFIG_SUNXI_USB=y
CONFIG_SUNXI_EFEX=y
CONFIG_SUNXI_FASTBOOT=y
CONFIG_SUNXI_BURN=y

#cmd
CONFIG_CMD_SUNXI_TIMER=y
CONFIG_CMD_SUNXI_SPRITE=y
CONFIG_CMD_SUNXI_EFEX=y
CONFIG_CMD_FASTBOOT=y
CONFIG_CMD_GPT=y
CONFIG_CMD_FAT=y
CONFIG_CMD_PART=y
CONFIG_CMD_SUNXI_BURN=y

#COMP
CONFIG_SUNXI_COMP_GZ=y
```

## configs/sun50iw10p1_android12_eink_defconfig
```kconfig
CONFIG_ARM=y
CONFIG_ARCH_SUNXI=y
CONFIG_MACH_SUN50IW10=y
#CONFIG_AXP_GPIO=y
CONFIG_DEFAULT_DEVICE_TREE="sun50iw10p1-soc-system"
# CONFIG_SYS_MALLOC_CLEAR_ON_INIT is not set
CONFIG_OF_SEPARATE=y
CONFIG_SUNXI_NECESSARY_REPLACE_FDT=y
CONFIG_CONSOLE_MUX=y
# CONFIG_OF_BOARD=y
CONFIG_SYS_TEXT_BASE=0x4A000000
CONFIG_SUNXI_MALLOC_LEN=0x5a00000

#secure
CONFIG_SUNXI_SECURE_BOOT=y
CONFIG_SUNXI_IMAGE_VERIFIER=y
CONFIG_SUNXI_KEYBOX=y
CONFIG_SUNXI_CE_21=y
CONFIG_SUNXI_DRM_SUPPORT=y
#system
CONFIG_ARM_SMCCC=y
CONFIG_SUNXI_DMA=y
CONFIG_PHYS_64BIT=y

#I2C
CONFIG_SYS_I2C_SUNXI=y
CONFIG_I2C0_ENABLE=y
CONFIG_SYS_SUNXI_I2C0_SPEED=40000000
CONFIG_SYS_SUNXI_I2C0_SLAVE=0x0
CONFIG_SYS_SUNXI_R_I2C0_SLAVE=0x34
CONFIG_SYS_SUNXI_R_I2C0_SPEED=400000
CONFIG_R_I2C0_ENABLE=y
#power
CONFIG_SUNXI_POWER=y
CONFIG_PMIC_TPS65185=y

CONFIG_SUNXI_PMU=y
CONFIG_SUNXI_BMU=y
CONFIG_AXP81X_POWER=y
CONFIG_AXP81X_SUNXI_I2C_SLAVE=0x34
CONFIG_AXP858_POWER=y
CONFIG_AXP858_SUNXI_I2C_SLAVE=0x36
CONFIG_AXP806_POWER=y
CONFIG_AXP806_SUNXI_I2C_SLAVE=0x36

CONFIG_AXP2202_POWER=y
CONFIG_AXP2202_SUNXI_I2C_SLAVE=0x34

# flash
CONFIG_SUNXI_SDMMC=y
CONFIG_MMC=y
CONFIG_SUNXI_FLASH=y
CONFIG_SUNXI_NAND=y

#nsi
CONFIG_SUNXI_NSI=y

#usb otg config
CONFIG_SUNXI_USB=y
CONFIG_SUNXI_EFEX=y
CONFIG_SUNXI_BURN=y

#partition
CONFIG_EFI_PARTITION=y
CONFIG_LAST_PARTITION_NAME="userdata"

#image
CONFIG_ANDROID_BOOT_IMAGE=y

#sprite
CONFIG_SUNXI_SPRITE=y
CONFIG_SUNXI_SECURE_STORAGE=y
CONFIG_SUNXI_SPRITE_CARTOON=y
CONFIG_SUNXI_UPDATE_GPT=y

#android
CONFIG_SUNXI_MAC=y
CONFIG_SUNXI_USER_KEY=y
CONFIG_SUNXI_AVB=y
CONFIG_SUNXI_ANDROID_BOOT=y
CONFIG_SUNXI_SERIAL=y
CONFIG_SUNXI_VERIFY_BOOT_INFO_INSTALL=y
CONFIG_ANDROID_AB=y

#cmd
CONFIG_CMD_SUNXI_TIMER=y
CONFIG_CMD_SUNXI_SPRITE=y
CONFIG_CMD_SUNXI_EFEX=y
CONFIG_CMD_SUNXI_BURN=y
CONFIG_CMD_GPT=y
CONFIG_CMD_FAT=y
CONFIG_CMD_SUNXI_MEMTEST=y
CONFIG_CMD_FASTBOOT=y
CONFIG_CMD_PART=y
CONFIG_CMD_AB_SELECT=y
#arisc
CONFIG_SUNXI_ARISC_EXIST=y

#overlay
CONFIG_SUNXI_ANDROID_OVERLAY=y

#turning
CONFIG_SUNXI_OTA_TURNNING=y
#
#eink
CONFIG_DISP2_SUNXI=y
CONFIG_EINK200_SUNXI=y


#
# Clock
#
CONFIG_CLK_SUNXI=y
```

## configs/sun50iw10p1_tina_evb2_rtl8363_defconfig
```kconfig
CONFIG_ARM=y
CONFIG_ARCH_SUNXI=y
CONFIG_MACH_SUN50IW10=y
#CONFIG_AXP_GPIO=y
CONFIG_DEFAULT_DEVICE_TREE="sun50iw10p1-common"
# CONFIG_SYS_MALLOC_CLEAR_ON_INIT is not set
CONFIG_CONSOLE_MUX=y
CONFIG_OF_BOARD=y
# CONFIG_OF_SEPARATE=y
CONFIG_SYS_TEXT_BASE=0x4A000000

#secure
CONFIG_SUNXI_SECURE_BOOT=y
CONFIG_SUNXI_IMAGE_VERIFIER=y
CONFIG_SUNXI_KEYBOX=y
CONFIG_SUNXI_CE_21=y
CONFIG_SUNXI_DRM_SUPPORT=y

# Environment
CONFIG_ENV_IS_IN_SUNXI_FLASH=y
CONFIG_SYS_MAXARGS=64
CONFIG_SUNXI_REDUNDAND_ENVIRONMENT=y
CONFIG_SYS_REDUNDAND_ENVIRONMENT=y
CONFIG_SUNXI_ENV_PARTITION="env"
CONFIG_SUNXI_ENV_REDUNDAND_PARTITION="env-redund"
CONFIG_ENV_SIZE=0x20000

#system
CONFIG_ARM_SMCCC=y
CONFIG_SUNXI_DMA=y
CONFIG_PHYS_64BIT=y

#I2C
CONFIG_SYS_I2C_SUNXI=y
CONFIG_SYS_SUNXI_R_I2C0_SLAVE=0x34
CONFIG_SYS_SUNXI_R_I2C0_SPEED=400000
CONFIG_R_I2C0_ENABLE=y
#power
CONFIG_SUNXI_POWER=y

CONFIG_SUNXI_PMU=y
CONFIG_AXP81X_POWER=y
CONFIG_AXP81X_SUNXI_I2C_SLAVE=0x34
CONFIG_AXP858_POWER=y
CONFIG_AXP858_SUNXI_I2C_SLAVE=0x36
CONFIG_AXP806_POWER=y
CONFIG_AXP806_SUNXI_I2C_SLAVE=0x36

# flash
CONFIG_SUNXI_SDMMC=y
CONFIG_MMC=y
CONFIG_SUNXI_FLASH=y
CONFIG_SUNXI_NAND=y
CONFIG_CMD_SUNXI_NAND=y

#usb otg config
CONFIG_SUNXI_USB=y
CONFIG_SUNXI_EFEX=y
CONFIG_SUNXI_BURN=y

#partition
CONFIG_EFI_PARTITION=y

#image
CONFIG_ANDROID_BOOT_IMAGE=y

#sprite
CONFIG_SUNXI_SPRITE=y
CONFIG_SUNXI_SECURE_STORAGE=y
CONFIG_SUNXI_SPRITE_CARTOON=y

#adc
# CONFIG_SUNXI_LRADC is not set

#peripheral device
# CONFIG_SUNXI_LRADC_VOL is not set

#android
CONFIG_SUNXI_MAC=y
CONFIG_SUNXI_USER_KEY=y
CONFIG_SUNXI_SERIAL=y
CONFIG_SUNXI_VERIFY_BOOT_INFO_INSTALL=y

#cmd
CONFIG_CMD_SUNXI_TIMER=y
CONFIG_CMD_SUNXI_SPRITE=y
CONFIG_CMD_SUNXI_EFEX=y
CONFIG_CMD_SUNXI_BURN=y
CONFIG_CMD_GPT=y
CONFIG_CMD_FAT=y
CONFIG_CMD_SUNXI_MEMTEST=y
CONFIG_CMD_FASTBOOT=y
CONFIG_CMD_PART=y
#arisc
CONFIG_SUNXI_ARISC_EXIST=y

#
# SUNXI LOGO DISPLAY
#
CONFIG_CMD_SUNXI_BMP=y
#CONFIG_SUNXI_ADVERT_PICTURE=y
CONFIG_LZMA=y
# CONFIG_SUNXI_SPINOR_BMP is not set
# CONFIG_ENABLE_ADVERT_PICTURE is not set
# CONFIG_CMD_SUNXI_JPEG is not set
CONFIG_DISP2_SUNXI=y
#CONFIG_HDMI_DISP2_SUNXI=y
# CONFIG_HDMI2_DISP2_SUNXI is not set
# CONFIG_VDPO_DISP2_SUNXI is not set
#CONFIG_TV_DISP2_SUNXI=y
# CONFIG_DISP2_TV_GM7121 is not set
# CONFIG_DISP2_TV_AC200 is not set
# CONFIG_EDP_DISP2_SUNXI is not set
# CONFIG_EINK_PANEL_USED is not set

#
# LCD panels select
#
CONFIG_LCD_SUPPORT_K101IM2QA04=y
CONFIG_LCD_SUPPORT_BP101WX1=y
CONFIG_LCD_SUPPORT_FX070=y
#CONFIG_LCD_SUPPORT_GG1P4062UTSW
# CONFIG_LCD_SUPPORT_DX0960BE40A1 is not set
# CONFIG_LCD_SUPPORT_TFT720X1280 is not set
# CONFIG_LCD_SUPPORT_FD055HD003S is not set
CONFIG_LCD_SUPPORT_HE0801A068=y
# CONFIG_LCD_SUPPORT_ILI9341 is not set
# CONFIG_LCD_SUPPORT_LH219WQ1 is not set
# CONFIG_LCD_SUPPORT_LS029B3SX02 is not set
# CONFIG_LCD_SUPPORT_LT070ME05000 is not set
# CONFIG_LCD_SUPPORT_S6D7AA0X01 is not set
# CONFIG_LCD_SUPPORT_T27P06 is not set
# CONFIG_LCD_SUPPORT_TFT720x1280 is not set
# CONFIG_LCD_SUPPORT_WTQ05027D01 is not set
# CONFIG_LCD_SUPPORT_H245QBN02 is not set
# CONFIG_LCD_SUPPORT_ST7789V is not set
# CONFIG_LCD_SUPPORT_ST7796S is not set
# CONFIG_LCD_SUPPORT_ST7701S is not set
# CONFIG_LCD_SUPPORT_T30P106 is not set
# CONFIG_LCD_SUPPORT_TO20T20000 is not set
# CONFIG_LCD_SUPPORT_FRD450H40014 is not set
# CONFIG_LCD_SUPPORT_S2003T46G is not set
# CONFIG_LCD_SUPPORT_WILLIAMLCD is not set
# CONFIG_LCD_SUPPORT_LQ101R1SX03 is not set
# CONFIG_LCD_SUPPORT_INET_DSI_PANEL is not set
# CONFIG_LCD_SUPPORT_WTL096601G03 is not set

#
# Display engine feature select
#
# CONFIG_DISP2_SUNXI_SUPPORT_SMBL is not set
# CONFIG_DISP2_SUNXI_SUPPORT_ENAHNCE is not set

#
# Clock
#
CONFIG_CLK_SUNXI=y

# BOOT GUI
#
CONFIG_BOOT_GUI=y
# CONFIG_UPDATE_DISPLAY_MODE is not set
# CONFIG_CONFIG_LCD_CHECK_SKIP_OPEN is not set
# CONFIG_BOOT_GUI_DOUBLE_BUF is not set
# CONFIG_BOOT_GUI_TEST is not set

# GMAC
CONFIG_RTL8363_NB=y
CONFIG_NETDEVICES=y
CONFIG_SUNXI_GETH=y
CONFIG_NET=y
CONFIG_NET_RANDOM_ETHADDR=y
CONFIG_CMD_MII=y
CONFIG_CMD_NET=y
CONFIG_CMD_TFTPBOOT=y
CONFIG_NET_TFTP_VARS=y
CONFIG_CMD_NFS=y
CONFIG_CMD_PING=y
```

## configs/sun50iw11p1_defconfig
```kconfig
CONFIG_ARM=y
CONFIG_ARCH_SUNXI=y
CONFIG_MACH_SUN50IW11=y
#CONFIG_AXP_GPIO=y
CONFIG_DEFAULT_DEVICE_TREE="sun50iw11-common"
# CONFIG_SYS_MALLOC_CLEAR_ON_INIT is not set
CONFIG_CONSOLE_MUX=y
CONFIG_OF_BOARD=y
CONFIG_SYS_TEXT_BASE=0x4A000000

#secure
#CONFIG_SUNXI_SECURE_BOOT=y
#CONFIG_SUNXI_CE_10=y
#system
CONFIG_ARM_SMCCC=y
CONFIG_SUONFIG

# flash
CONFIG_SUNXI_SDMMC=y
CONFIG_MMC=y
CONFIG_SUNXI_FLASH=y
#CONFIG_SUNXI_NAND=y

#usb otg config
CONFIG_SUNXI_USB=y
CONFIG_SUNXI_EFEX=y
#CONFIG_SUNXI_BURN=y

#partition
CONFIG_EFI_PARTITION=y

#image
CONFIG_ANDROID_BOOT_IMAGE=y

#sprite
CONFIG_SUNXI_SPRITE=y
CONFIG_SUNXI_SECURE_STORAGE=y

#power
CONFIG_SUNXI_NO_PMIC=y

#cmd
CONFIG_CMD_SUNXI_TIMER=y
CONFIG_CMD_SUNXI_SPRITE=y
CONFIG_CMD_SUNXI_EFEX=y
CONFIG_CMD_SUNXI_BURN=y
CONFIG_CMD_GPT=y
CONFIG_CMD_FAT=y

#arisc
#CONFIG_SUNXI_ARISC_EXIST=y
```

## configs/sun50iw11p1_mmc_defconfig
```kconfig
CONFIG_ARM=y
CONFIG_ARCH_SUNXI=y
CONFIG_MACH_SUN50IW11=y
#CONFIG_AXP_GPIO=y
CONFIG_DEFAULT_DEVICE_TREE="sun50iw11-soc"
# CONFIG_SYS_MALLOC_CLEAR_ON_INIT is not set
CONFIG_CONSOLE_MUX=y
CONFIG_PRE_CONSOLE_BUFFER=n
CONFIG_OF_BOARD=y
#CONFIG_OF_SEPARATE=y
CONFIG_SYS_TEXT_BASE=0x43000000
CONFIG_SUNXI_FDT_ADDR=0x41700000

#system
CONFIG_ARM_SMCCC=y
CONFIG_SUONFIG

# Environment
CONFIG_ENV_IS_IN_SUNXI_FLASH=y
CONFIG_SYS_MAXARGS=64
CONFIG_SUNXI_REDUNDAND_ENVIRONMENT=y
CONFIG_SYS_REDUNDAND_ENVIRONMENT=y
CONFIG_SUNXI_ENV_PARTITION="env"
CONFIG_SUNXI_ENV_REDUNDAND_PARTITION="env-redund"
CONFIG_ENV_SIZE=0x20000

# flash
CONFIG_SUNXI_SDMMC=y
CONFIG_MMC=y
CONFIG_SUNXI_FLASH=y
# CONFIG_SUNXI_NAND is not set
# CONFIG_SUNXI_UBIFS is not set
# CONFIG_SUNXI_COMM_NAND is not set
# CONFIG_SUNXI_COMM_NAND_V1 is not set

#usb otg config
CONFIG_SUNXI_USB=y
CONFIG_SUNXI_EFEX=y
#CONFIG_SUNXI_BURN=y

#partition
CONFIG_EFI_PARTITION=y

#image
CONFIG_ANDROID_BOOT_IMAGE=y

#sprite
CONFIG_SUNXI_SPRITE=y
CONFIG_SUNXI_SECURE_STORAGE=y

#power
CONFIG_SUNXI_NO_PMIC=y

#cmd
CONFIG_CMD_SUNXI_TIMER=y
CONFIG_CMD_SUNXI_SPRITE=y
CONFIG_CMD_SUNXI_EFEX=y
CONFIG_CMD_SUNXI_BURN=y
CONFIG_CMD_GPT=y
CONFIG_CMD_FAT=y
CONFIG_CMD_SUNXI_MEMTEST=y
CONFIG_CMD_SUNXI_BOOTR=y

#arisc
#CONFIG_SUNXI_ARISC_EXIST=y

CONFIG_XTENSA_DSP=y
CONFIG_SUNXI_VERIFY_DSP=y
CONFIG_SUNXI_SPINOR_BMP=y


#COMP
CONFIG_SUNXI_COMP_GZ=y

#serailNo
CONFIG_SUNXI_SERIAL=y
CONFIG_SUNXI_USER_KEY=y
```

## configs/sun50iw11p1_nor_defconfig
```kconfig
CONFIG_ARM=y
CONFIG_ARCH_SUNXI=y
CONFIG_MACH_SUN50IW11=y
#CONFIG_AXP_GPIO=y
CONFIG_DEFAULT_DEVICE_TREE="sun50iw11-soc"
# CONFIG_SYS_MALLOC_CLEAR_ON_INIT is not set
CONFIG_CONSOLE_MUX=y
CONFIG_PRE_CONSOLE_BUFFER=n
CONFIG_OF_BOARD=y
#CONFIG_OF_SEPARATE=y
CONFIG_SYS_TEXT_BASE=0x43000000
CONFIG_SUNXI_FDT_ADDR=0x41700000

#system
CONFIG_ARM_SMCCC=y
CONFIG_SUNXI_DMA=y
#I2C
CONFIG_SYS_I2C_SUNXI=y
CONFIG_SYS_SUNXI_I2C_SLAVE=0x50
CONFIG_SYS_SUNXI_I2C_SPEED=400000
CONFIG_I2C0_ENABLE=y
CONFIG_I2C1_ENABLE=y

#key
CONFIG_SUNXI_PHY_KEY=y
CONFIG_SUNXI_LRADC_KEY=y

#SPI
CONFIG_SPI=y
CONFIG_SUNXI_SPI=y
CONFIG_SPI_USE_DMA=y
CONFIG_SPI_FLASH=y
CONFIG_SPI_FLASH_WINBOND=y
CONFIG_SPI_FLASH_EON=y
CONFIG_SPI_FLASH_GIGADEVICE=y
CONFIG_SPI_FLASH_ISSI=y
CONFIG_SPI_FLASH_MACRONIX=y
CONFIG_SPI_FLASH_SPANSION=y
CONFIG_SPI_FLASH_ATMEL=y
CONFIG_SPI_FLASH_STMICRO=y
CONFIG_SPI_FLASH_SST=y
CONFIG_SPI_FLASH_PUYA=y
CONFIG_SPI_FLASH_FM=y
CONFIG_SPI_FLASH_XMC=y

CONFIG_SF_DEFAULT_SPEED=50000000
# BIT(12) BIT(13) (SPI_RX_DUAL|SPI_RX_QUAD)
CONFIG_SF_DEFAULT_MODE=0x3000

#
# PWM_SUNXI
#
# CONFIG_PWM_SUNXI is not set
CONFIG_PWM_SUNXI_NEW=y

CONFIG_SPINOR_UBOOT_OFFSET=128
CONFIG_SPINOR_LOGICAL_OFFSET=2016

# flash
CONFIG_SUNXI_FLASH=y
CONFIG_SUNXI_SPINOR=y
CONFIG_SUNXI_NOR_IMG=y

#usb otg config
CONFIG_SUNXI_USB=y
CONFIG_SUNXI_EFEX=y
#CONFIG_SUNXI_BURN=y
CONFIG_SUNXI_FASTBOOT=y
#partition
CONFIG_EFI_PARTITION=y

#image
CONFIG_ANDROID_BOOT_IMAGE=y

#sprite
CONFIG_SUNXI_SPRITE=y
CONFIG_SUNXI_SECURE_STORAGE=y

#cmd
CONFIG_CMD_SUNXI_TIMER=y
CONFIG_CMD_SUNXI_SPRITE=y
CONFIG_CMD_SUNXI_EFEX=y
CONFIG_CMD_SUNXI_BURN=y
CONFIG_CMD_GPT=y
CONFIG_CMD_FAT=y
CONFIG_CMD_FASTBOOT=y
CONFIG_CMD_SUNXI_DMA=y
CONFIG_CMD_SUNXI_MEMTEST=y
CONFIG_CMD_PART=y
CONFIG_CMD_SF=y
CONFIG_CMD_SF_TEST=y
CONFIG_CMD_SUNXI_AUTO_FEL=n
CONFIG_CMD_SUNXI_BOOTR=y
#arisc
#CONFIG_SUNXI_ARISC_EXIST=y

#dsp
CONFIG_XTENSA_DSP=y

#serailNo
CONFIG_SUNXI_SERIAL=y
CONFIG_SUNXI_USER_KEY=y
```

## configs/sun50iw11p1_rawnand_mmc_defconfig
```kconfig
CONFIG_ARM=y
CONFIG_ARCH_SUNXI=y
CONFIG_MACH_SUN50IW11=y
#CONFIG_AXP_GPIO=y
CONFIG_DEFAULT_DEVICE_TREE="sun50iw11-soc"
# CONFIG_SYS_MALLOC_CLEAR_ON_INIT is not set
CONFIG_CONSOLE_MUX=y
CONFIG_PRE_CONSOLE_BUFFER=n
CONFIG_OF_BOARD=y
#CONFIG_OF_SEPARATE=y
CONFIG_SYS_TEXT_BASE=0x43000000
CONFIG_SUNXI_FDT_ADDR=0x41700000

# Environment
CONFIG_ENV_IS_IN_SUNXI_FLASH=y
CONFIG_SYS_MAXARGS=64
CONFIG_SUNXI_REDUNDAND_ENVIRONMENT=y
CONFIG_SYS_REDUNDAND_ENVIRONMENT=y
CONFIG_SUNXI_ENV_PARTITION="env"
CONFIG_SUNXI_ENV_REDUNDAND_PARTITION="env-redund"
CONFIG_ENV_SIZE=0x20000

#system
CONFIG_ARM_SMCCC=y
CONFIG_SUNXI_DMA=y
#I2C
CONFIG_SYS_I2C_SUNXI=y
CONFIG_SYS_SUNXI_I2C_SLAVE=0x50
CONFIG_SYS_SUNXI_I2C_SPEED=400000
CONFIG_I2C0_ENABLE=y
CONFIG_I2C1_ENABLE=y

#axp
#CONFIG_R_I2C0_ENABLE=y
#CONFIG_SYS_SUNXI_R_I2C0_SLAVE=0x34
#CONFIG_SYS_SUNXI_R_I2C0_SPEED=400000
#CONFIG_SUNXI_POWER=y
#CONFIG_SUNXI_PMU=y
#CONFIG_SUNXI_BMU=y
#CONFIG_AXP2585_POWER=y

#key
CONFIG_SUNXI_PHY_KEY=y
CONFIG_SUNXI_LRADC_KEY=y

#SPI
CONFIG_SPI=y
CONFIG_SUNXI_SPI=y
CONFIG_SPI_USE_DMA=y
CONFIG_SPI_FLASH=y
CONFIG_SPI_FLASH_WINBOND=y
CONFIG_SPI_FLASH_EON=y
CONFIG_SPI_FLASH_GIGADEVICE=y
CONFIG_SPI_FLASH_ISSI=y
CONFIG_SPI_FLASH_MACRONIX=y
CONFIG_SPI_FLASH_SPANSION=y
CONFIG_SPI_FLASH_ATMEL=y
CONFIG_SPI_FLASH_STMICRO=y
CONFIG_SPI_FLASH_SST=y
CONFIG_SPI_FLASH_PUYA=y
CONFIG_SPI_FLASH_FM=y
CONFIG_SPI_FLASH_XMC=y

CONFIG_SF_DEFAULT_SPEED=50000000
# BIT(12) BIT(13) (SPI_RX_DUAL|SPI_RX_QUAD)
CONFIG_SF_DEFAULT_MODE=0x3000

#
# PWM_SUNXI
#
# CONFIG_PWM_SUNXI is not set
CONFIG_PWM_SUNXI_NEW=y

CONFIG_SPINOR_UBOOT_OFFSET=128
CONFIG_SPINOR_LOGICAL_OFFSET=2016

# flash
CONFIG_SUNXI_FLASH=y
CONFIG_SUNXI_SDMMC=y
CONFIG_SUNXI_NAND=y
CONFIG_SUNXI_SPINOR=y
# CONFIG_SUNXI_UBIFS is not set
# CONFIG_SUNXI_COMM_NAND is not set
CONFIG_SUNXI_COMM_NAND_V1=y
CONFIG_SUNXI_TURNNING_DRAM=n

#usb otg config
CONFIG_SUNXI_USB=y
CONFIG_SUNXI_EFEX=y
CONFIG_SUNXI_BURN=y
CONFIG_SUNXI_FASTBOOT=y
#partition
CONFIG_EFI_PARTITION=y

#image
CONFIG_ANDROID_BOOT_IMAGE=y

#sprite
CONFIG_SUNXI_SPRITE=y
CONFIG_SUNXI_SECURE_STORAGE=y

#secure
CONFIG_SUNXI_SECURE_BOOT=y
CONFIG_SUNXI_CE_10=y
CONFIG_SUNXI_KEYBOX=y
CONFIG_SUNXI_IMAGE_HEADER=y

#cmd
CONFIG_CMD_SUNXI_TIMER=y
CONFIG_CMD_SUNXI_SPRITE=y
CONFIG_CMD_SUNXI_EFEX=y
CONFIG_CMD_SUNXI_BURN=y
CONFIG_CMD_GPT=y
CONFIG_CMD_FAT=y
CONFIG_CMD_FASTBOOT=y
CONFIG_CMD_SUNXI_DMA=y
CONFIG_CMD_SUNXI_MEMTEST=y
CONFIG_CMD_PART=y
CONFIG_CMD_SF=y
CONFIG_CMD_SF_TEST=y
CONFIG_CMD_SUNXI_AUTO_FEL=n
CONFIG_CMD_SUNXI_BOOTR=y
#arisc
#CONFIG_SUNXI_ARISC_EXIST=y

#dsp
CONFIG_XTENSA_DSP=y
CONFIG_SUNXI_VERIFY_DSP=y
# CONFIG_SUNXI_INITRD_ROUTINE is not set
CONFIG_SUNXI_SPINOR_BMP=y

CONFIG_MMC=y

CONFIG_BOOTCMD_SKIP_MISC=y
CONFIG_BOOTCMD_SKIP_ADCKEY=y
# CONFIG_BOOTCMD_SKIP_RTC is not set

#COMP
CONFIG_SUNXI_COMP_GZ=y

#serailNo
CONFIG_SUNXI_SERIAL=y
CONFIG_SUNXI_USER_KEY=y
```
