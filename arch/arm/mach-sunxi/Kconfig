## configs/sun50iw12p1_defconfig
```kconfig
CONFIG_ARM=y
CONFIG_ARCH_SUNXI=y
CONFIG_MACH_SUN50IW12=y
#CONFIG_AXP_GPIO=y
CONFIG_SYS_CONFIG_NAME="sun50iw12p1"
CONFIG_DEFAULT_DEVICE_TREE="sun50iw12p1-soc-system"
# CONFIG_SYS_MALLOC_CLEAR_ON_INIT is not set
CONFIG_CONSOLE_MUX=y
CONFIG_PRE_CONSOLE_BUFFER=n
CONFIG_OF_SEPARATE=y
CONFIG_SUNXI_NECESSARY_REPLACE_FDT=y
CONFIG_SYS_TEXT_BASE=0x4A000000
CONFIG_SUNXI_FDT_ADDR=0x41800000

#system
CONFIG_ARM_SMCCC=y
CONFIG_SUNXI_DMA=y
#I2C
CONFIG_SYS_I2C_SUNXI=y
CONFIG_SYS_SUNXI_I2C_SLAVE=0x50
CONFIG_SYS_SUNXI_I2C_SPEED=400000
CONFIG_I2C0_ENABLE=y
CONFIG_I2C1_ENABLE=y

#RTC
CONFIG_START_MODE_RTC_REG_INDEX=0x2

#axp
#CONFIG_R_I2C0_ENABLE=y
#CONFIG_SYS_SUNXI_R_I2C0_SLAVE=0x34
#CONFIG_SYS_SUNXI_R_I2C0_SPEED=400000
#CONFIG_SUNXI_POWER=y
#CONFIG_SUNXI_PMU=y
#CONFIG_SUNXI_BMU=y
#CONFIG_AXP2585_POWER=y

#key
CONFIG_SUNXI_PHY_KEY=y
CONFIG_SUNXI_LRADC_KEY=y
CONFIG_SUNXI_GPIO_V2=y

#crypto driver
CONFIG_SUNXI_CE_DRIVER=y
CONFIG_SUNXI_CE_23=y

CONFIG_SF_DEFAULT_SPEED=50000000
# BIT(12) BIT(13) (SPI_RX_DUAL|SPI_RX_QUAD)
CONFIG_SF_DEFAULT_MODE=0x3000

#
# PWM_SUNXI
#
# CONFIG_PWM_SUNXI is not set
CONFIG_PWM_SUNXI_NEW=y

CONFIG_SPINOR_UBOOT_OFFSET=128
CONFIG_SPINOR_LOGICAL_OFFSET=2016

# flash
CONFIG_SUNXI_SDMMC=y
CONFIG_MMC=y
CONFIG_SUNXI_FLASH=y
CONFIG_SUNXI_NAND=y
CONFIG_CMD_SUNXI_NAND=y
CONFIG_SUNXI_COMM_NAND_V1=y

#usb otg config
CONFIG_SUNXI_USB=y
CONFIG_SUNXI_EFEX=y
CONFIG_SUNXI_BURN=y
CONFIG_SUNXI_FASTBOOT=y

#usb hcd
CONFIG_USB=y
CONFIG_USB_EHCI_HCD=y
CONFIG_USB_STORAGE=y
CONFIG_USB0_VBUS_PIN="PH14"
CONFIG_USB1_VBUS_PIN="PH14"

#partition
CONFIG_EFI_PARTITION=y

#image
CONFIG_ANDROID_BOOT_IMAGE=y

#android
CONFIG_SUNXI_MAC=y
CONFIG_SUNXI_USER_KEY=y
CONFIG_SUNXI_AVB=y
CONFIG_SUNXI_ANDROID_BOOT=y
CONFIG_SUNXI_SERIAL=y
CONFIG_SUNXI_VERIFY_BOOT_INFO_INSTALL=y
CONFIG_ANDROID_AB=y
CONFIG_SUNXI_ANDROID_OVERLAY=y

#sprite
CONFIG_SUNXI_SPRITE=y
CONFIG_SUNXI_SECURE_STORAGE=y
CONFIG_SUNXI_SPRITE_CARTOON=y

#cmd
CONFIG_CMD_SUNXI_TIMER=y
CONFIG_CMD_SUNXI_SPRITE=y
CONFIG_CMD_SUNXI_EFEX=y
CONFIG_CMD_SUNXI_BURN=y
CONFIG_CMD_GPT=y
CONFIG_CMD_FAT=y
CONFIG_CMD_FASTBOOT=y
CONFIG_CMD_SUNXI_DMA=y
CONFIG_CMD_SUNXI_MEMTEST=y
CONFIG_CMD_PART=y
CONFIG_CMD_SUNXI_AUTO_FEL=n
CONFIG_CMD_SUNXI_BOOTR=y
CONFIG_CMD_USB=y

#arisc
CONFIG_SUNXI_ARISC_EXIST=y
CONFIG_ARISC_DEASSERT_BEFORE_KERNEL=y

#tv fake poweroff
CONFIG_ATF_BOX_STANDBY=y

#secure
CONFIG_SUNXI_SECURE_BOOT=y
CONFIG_SUNXI_IMAGE_VERIFIER=y
CONFIG_SUNXI_KEYBOX=y
CONFIG_SUNXI_DRM_SUPPORT=y
CONFIG_SUNXI_EXTERN_SECURE_MM_LAYOUT=y

CONFIG_SUNXI_MIPS=y
CONFIG_SUNXI_TV_FASTLOGO=y
CONFIG_SUNXI_FASTLOGO_JPEG=y
CONFIG_SUNXI_FDT_SAVE=y

#product features
CONFIG_SUNXI_HOMLET=y
CONFIG_SUNXI_HDCP_IN_SECURESTORAGE=y
CONFIG_SUNXI_HDCP_HASH=n
```

## configs/sun50iw3p1_defconfig
```kconfig
CONFIG_ARM=y
CONFIG_ARCH_SUNXI=y
CONFIG_MACH_SUN50IW3=y
#CONFIG_AXP_GPIO=y
CONFIG_DEFAULT_DEVICE_TREE="sun50iw3-common"
# CONFIG_SYS_MALLOC_CLEAR_ON_INIT is not set
CONFIG_CONSOLE_MUX=y
# CONFIG_CMD_FLASH is not set
# CONFIG_SPL_DOS_PARTITION is not set
# CONFIG_SPL_EFI_PARTITION is not set
# CONFIG_AXP_DLDO4_VOLT=3300
# CONFIG_USB_EHCI_HCD=y
# CONFIG_USB_MUSB_HOST=y
# CONFIG_SYS_USB_EVENT_POLL_VIA_INT_QUEUE=y
CONFIG_OF_BOARD=y
CONFIG_SYS_TEXT_BASE=0x4a000000

#system
CONFIG_ARM_SMCCC=y
CONFIG_SUNXI_DMA=y

# flash
CONFIG_SUNXI_FLASH=y
CONFIG_SUNXI_NAND=y

#usb otg config
CONFIG_SUNXI_USB=y
CONFIG_SUNXI_EFEX=y
CONFIG_SUNXI_FASTBOOT=y
#usb hcd
CONFIG_USB=y
CONFIG_USB_EHCI_HCD=y
CONFIG_USB_STORAGE=y
CONFIG_USB0_VBUS_PIN="PB0"
CONFIG_USB1_VBUS_PIN="PB1"

#partition
CONFIG_EFI_PARTITION=y
CONFIG_CMD_PART=y

#image
CONFIG_ANDROID_BOOT_IMAGE=y

#sprite
CONFIG_SUNXI_SPRITE=y

#cmd
CONFIG_CMD_SUNXI_TIMER=y
CONFIG_CMD_SUNXI_SPRITE=y
CONFIG_CMD_SUNXI_EFEX=y
CONFIG_CMD_GPT=y
CONFIG_CMD_FAT=y
CONFIG_CMD_SUNXI_DMA=y
CONFIG_CMD_USB=y
CONFIG_CMD_SUNXI_MEMTEST=y

#power
CONFIG_SUNXI_NO_PMIC=y
```

## configs/sun50iw5p1_defconfig
```kconfig
CONFIG_ARM=y
CONFIG_ARCH_SUNXI=y
CONFIG_MACH_SUN50IW5=y
#CONFIG_AXP_GPIO=y
CONFIG_DEFAULT_DEVICE_TREE="sun50iw5-common"
# CONFIG_SYS_MALLOC_CLEAR_ON_INIT is not set
CONFIG_CONSOLE_MUX=y
CONFIG_OF_BOARD=y
CONFIG_SYS_TEXT_BASE=0x4A000000

#system
CONFIG_ARM_SMCCC=y
CONFIG_SUNXI_DMA=y
CONFIG_PHYS_64BIT=y

#I2C
CONFIG_SYS_I2C_SUNXI=y
CONFIG_SYS_SUNXI_R_I2C0_SLAVE=0x34
CONFIG_SYS_SUNXI_R_I2C0_SPEED=400000
CONFIG_R_I2C0_ENABLE=y
#power
CONFIG_SUNXI_POWER=y
CONFIG_SUNXI_PMU=y
CONFIG_AXP1530_POWER=y
CONFIG_AXP1530_SUNXI_I2C_SLAVE=0x36
CONFIG_SUNXI_AXP152_POWER=y
CONFIG_AXP152_SUNXI_I2C_SLAVE=0x30
CONFIG_AXP858_POWER=y
CONFIG_AXP858_SUNXI_I2C_SLAVE=0x36
CONFIG_AXP806_POWER=y
CONFIG_AXP806_SUNXI_I2C_SLAVE=0x36



# flash
CONFIG_SUNXI_SDMMC=y
CONFIG_MMC=y
CONFIG_SUNXI_FLASH=y
CONFIG_SUNXI_BOOT0_SDMMC_BACKUP_START_ADDR=512

#usb otg config
CONFIG_SUNXI_USB=y
CONFIG_SUNXI_EFEX=y
CONFIG_SUNXI_BURN=y

#usb hcd
CONFIG_USB=y
CONFIG_USB_EHCI_HCD=y
CONFIG_USB_STORAGE=y
CONFIG_USB0_VBUS_PIN="PI11"
CONFIG_USB1_VBUS_PIN="PI11"
CONFIG_USB2_VBUS_PIN="PI11"
CONFIG_USB3_VBUS_PIN="PI11"

#partition
CONFIG_EFI_PARTITION=y

#image
CONFIG_ANDROID_BOOT_IMAGE=y

#sprite
CONFIG_SUNXI_SPRITE=y
CONFIG_SUNXI_SECURE_STORAGE=y
CONFIG_SUNXI_SPRITE_CARTOON=y
CONFIG_SUNXI_AUTO_UPDATE=y

#power
CONFIG_SUNXI_NO_PMIC=y
CONFIG_SUNXI_TRY_POWER_SPLY=y

#secure feature
CONFIG_SUNXI_SECURE_BOOT=y
CONFIG_SUNXI_IMAGE_VERIFIER=y
CONFIG_SUNXI_KEYBOX=y

#android
CONFIG_SUNXI_MAC=y
CONFIG_SUNXI_USER_KEY=y
CONFIG_SUNXI_AVB=y
CONFIG_SUNXI_ANDROID_BOOT=y
CONFIG_SUNXI_SERIAL=y

#homlet
CONFIG_SUNXI_HOMLET=y
CONFIG_RECOVERY_KEY=y
CONFIG_IR_BOOT_RECOVERY=y
CONFIG_SUNXI_DRM_SUPPORT=y
CONFIG_SUNXI_HDCP_IN_SECURESTORAGE=y
CONFIG_SUNXI_HDCP_HASH=n

#cmd
CONFIG_CMD_SUNXI_TIMER=y
CONFIG_CMD_SUNXI_SPRITE=y
CONFIG_CMD_SUNXI_EFEX=y
CONFIG_CMD_SUNXI_BURN=y
CONFIG_CMD_GPT=y
CONFIG_CMD_FAT=y
CONFIG_CMD_SUNXI_MEMTEST=y
CONFIG_CMD_FASTBOOT=y
CONFIG_CMD_USB=y
#overlay
CONFIG_SUNXI_OVERLAY=y

#box_standby
CONFIG_ATF_BOX_STANDBY=y
```
