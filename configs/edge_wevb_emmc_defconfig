## configs/edge_wevb_emmc_defconfig
```kconfig
CONFIG_ARM=y
CONFIG_SYS_MALLOC_F_LEN=0x3000
CONFIG_NR_DRAM_BANKS=1
CONFIG_DEFAULT_DEVICE_TREE="bm1688_wevb_emmc"
CONFIG_IDENT_STRING=" cvitek_sophgo"
CONFIG_ARMV8_SET_SMPEN=y
CONFIG_TARGET_CVITEK_CV186X=y
CONFIG_DISTRO_DEFAULTS=y
CONFIG_FIT=y
CONFIG_BOARD_LATE_INIT=y
CONFIG_ARCH_FIXUP_FDT_MEMORY=y
CONFIG_BOOTDELAY=1
# CONFIG_DISPLAY_CPUINFO is not set
# CONFIG_DISPLAY_BOARDINFO is not set
CONFIG_SYS_PROMPT="sophon# "
# CONFIG_CMD_CONSOLE is not set
# CONFIG_CMD_XIMG is not set
# CONFIG_CMD_EDITENV is not set
# CONFIG_CMD_CRC32 is not set
# CONFIG_CMD_LZMADEC is not set
# CONFIG_CMD_UNLZ4 is not set
CONFIG_CMD_UNZIP=y
CONFIG_CMD_GPT=y
# CONFIG_CMD_LOADS is not set
# CONFIG_CMD_ITEST is not set
CONFIG_CMD_CACHE=y
CONFIG_CMD_CVI_SD_UPDATE=y
# CONFIG_ISO_PARTITION is not set
# CONFIG_EFI_PARTITION is not set
CONFIG_OF_CONTROL=y
CONFIG_PHYLIB=y
# CONFIG_PHY_BROADCOM is not set
CONFIG_PHY_SMSC=y
# CONFIG_PHY_FIXED is not set
CONFIG_PHY_REALTEK=y
CONFIG_PHY_MARVELL=n
CONFIG_DWC_ETH_QOS=y
CONFIG_DM_ETH=y
CONFIG_NETDEVICES=y
CONFIG_ETH_DESIGNWARE=y
CONFIG_NET_RANDOM_ETHADDR=y
CONFIG_DM=y
CONFIG_DM_MMC=y
CONFIG_MMC=y
CONFIG_MMC_SDHCI=y
CONFIG_MMC_SDHCI_SDMA=y
CONFIG_MMC_SDHCI_CVITEK=y
CONFIG_MTD=y
# CONFIG_SPI_FLASH is not set
# CONFIG_PHY_SMSC is not set
# CONFIG_DM_ETH=y
# CONFIG_ETH_DESIGNWARE=y
#CONFIG_PHY_CVITEK=y
CONFIG_SYS_NS16550=y
CONFIG_BAUDRATE=115200
CONFIG_SPI=y
CONFIG_LZ4=y
CONFIG_LZMA=y
CONFIG_DM_GPIO=y
CONFIG_CMD_GPIO=y
CONFIG_DWAPB_GPIO=y
CONFIG_CMD_GPIO=y
# CONFIG_TOOLS_LIBCRYPTO is not set
CONFIG_CMD_MMC=y
CONFIG_ROOTFS_UBUNTU=n
CONFIG_ROOTFS_DEBIAN=n

CONFIG_ADC=y
CONFIG_ADC_CVITEK=y
CONFIG_DM_REGULATOR=y
CONFIG_CMD_ADC=y

CONFIG_DM_PWM=y
CONFIG_CMD_PWM=y
CONFIG_PWM_CVITEK=y
CONFIG_LED_GPIO=y
CONFIG_LED=y
CONFIG_CMD_LED=y
CONFIG_CMD_BM_SAVELOG=y
CONFIG_CONSOLE_RECORD=y
CONFIG_CONSOLE_RECORD_OUT_SIZE=0x2000

CONFIG_WATCHDOG=y
CONFIG_WATCHDOG_AUTOSTART=y
CONFIG_WATCHDOG_TIMEOUT_MSECS=60000
CONFIG_DESIGNWARE_WATCHDOG=y
CONFIG_WDT=y

CONFIG_SOPHON_SPACC_SHA=y

#
# VO
#
# CONFIG_VIDEO_SOPH is not set
# CONFIG_DISPLAY_SOPH_HDMI is not set
# CONFIG_LOGO_FROM_INTERNEL is not set

CONFIG_USB=y
CONFIG_DM_USB=y
CONFIG_USB_HOST=y
CONFIG_CMD_USB=y
CONFIG_USB_DWC3=y
CONFIG_USB_XHCI_DWC3_OF_SIMPLE=y
CONFIG_USB_XHCI_HCD=y
CONFIG_USB_XHCI_DWC3=y
CONFIG_USB_STORAGE=y
CONFIG_CMD_FAT=y
CONFIG_AUTOBOOT_KEYED=y
CONFIG_AUTOBOOT_DELAY_STR="\x03"
CONFIG_AUTOBOOT_STOP_STR="\x03"
CONFIG_AUTOBOOT_KEYED_CTRLC=y
CONFIG_MULTI_DTB_FIT=y
CONFIG_OF_LIST="cv186ah_se9b1_4G  cv186ah_se9v1_4G cv186ah_se9b2_4G cv186ah_se9b3_4G cv186ah_se9b4_4G cv186ah_se9k1_4G cv186ah_sm9v1_4G cv186ah_wevb_4G"

CONFIG_USE_DEFAULT_ENV=y
CONFIG_ROOTFS_UBUNTU=y
CONFIG_OF_LIBFDT_OVERLAY=y
```

## configs/sun55iw3p1_t527_defconfig
```kconfig
CONFIG_ARM=y
CONFIG_ARCH_SUNXI=y
CONFIG_MACH_SUN55IW3=y
CONFIG_SUNXI_GPIO_V2=y
CONFIG_SUNXI_PHY_KEY=y
#CONFIG_AXP_GPIO=y
CONFIG_DEFAULT_DEVICE_TREE="sun55iw3p1-soc-system"
# CONFIG_SYS_MALLOC_CLEAR_ON_INIT is not set
CONFIG_CONSOLE_MUX=y
#CONFIG_OF_BOARD=y
CONFIG_SYS_TEXT_BASE=0x4A000000
CONFIG_SUNXI_TEXT_SIZE=0x180000
#secure
#CONFIG_SUNXI_SECURE_BOOT=y
#CONFIG_SUNXI_IMAGE_VERIFIER=y
#CONFIG_SUNXI_KEYBOX=y
CONFIG_SUNXI_DRM_SUPPORT=y
#system
CONFIG_ARM_SMCCC=y
CONFIG_SUNXI_DMA=y
CONFIG_PHYS_64BIT=y
CONFIG_RECOVERY_KEY=y

CONFIG_ARM_SMCCC=y
CONFIG_SUNXI_DMA=y
CONFIG_PHYS_64BIT=y

CONFIG_CMD_DHCP=y
CONFIG_CMD_PXE=y

CONFIG_DISTRO_DEFAULTS=y
CONFIG_ENV_VARS_UBOOT_CONFIG=y

CONFIG_EXT4_WRITE=y
CONFIG_CMD_EXT4_WRITE=y
CONFIG_ENV_IS_IN_EXT4=y
#CONFIG_ENV_IS_IN_SUNXI_FLASH=y


#I2C
CONFIG_SYS_I2C_SUNXI=y
CONFIG_SYS_SUNXI_R_I2C0_SLAVE=0x35
CONFIG_SYS_SUNXI_R_I2C0_SPEED=400000
CONFIG_R_I2C0_ENABLE=y
#power
CONFIG_SUNXI_POWER=y
CONFIG_SUNXI_UBOOT_POWER_OFF=y

CONFIG_SUNXI_PMU=y
CONFIG_SUNXI_BMU=y
CONFIG_SUNXI_LRADC_KEY=y
CONFIG_SUNXI_PMU_EXT=y
CONFIG_AXP81X_POWER=y
CONFIG_AXP81X_SUNXI_I2C_SLAVE=0x34
CONFIG_AXP858_POWER=y
CONFIG_AXP858_SUNXI_I2C_SLAVE=0x36
CONFIG_AXP806_POWER=y
CONFIG_AXP806_SUNXI_I2C_SLAVE=0x36

CONFIG_AXP2202_POWER=y
CONFIG_AXP2202_SUNXI_I2C_SLAVE=0x35

CONFIG_TCS4838_POWER=y
CONFIG_TCS4838_SUNXI_I2C_SLAVE=0x41
CONFIG_SY8827G_POWER=y
CONFIG_SY8827G_SUNXI_I2C_SLAVE=0x60

CONFIG_AXP1530_POWER=y
CONFIG_AXP1530_SUNXI_I2C_SLAVE=0x36


# flash
CONFIG_SUNXI_SDMMC=y
CONFIG_MMC=y
CONFIG_SUNXI_NAND=y
CONFIG_SUNXI_UBIFS=y
CONFIG_SUNXI_FLASH=y
CONFIG_SPI_SAMP_DL_EN=y
CONFIG_SPI=y
CONFIG_SUNXI_SPI=y
CONFIG_SPI_USE_DMA=y
CONFIG_SPI_FLASH=y
CONFIG_SPI_FLASH_WINBOND=y
CONFIG_SPI_FLASH_EON=y
CONFIG_SPI_FLASH_GIGADEVICE=y
CONFIG_SPI_FLASH_ISSI=y
CONFIG_SPI_FLASH_MACRONIX=y
CONFIG_SPI_FLASH_SPANSION=y
CONFIG_SPI_FLASH_ATMEL=y
CONFIG_SPI_FLASH_STMICRO=y
CONFIG_SPI_FLASH_SST=y
CONFIG_SPI_FLASH_PUYA=y
CONFIG_SPI_FLASH_FM=y
CONFIG_SPI_FLASH_XT=y
CONFIG_SPI_FLASH_ADESTO=y
CONFIG_SPI_FLASH_XMC=y
CONFIG_SF_DEFAULT_MODE=0x3000
CONFIG_SF_DEFAULT_SPEED=20000000
CONFIG_SPINOR_UBOOT_OFFSET=128
CONFIG_SPINOR_LOGICAL_OFFSET=4096
CONFIG_SUNXI_SPINOR=y
CONFIG_SUNXI_DUAL_STORAGE=y

#
# sunxi-nand
#
CONFIG_AW_MTD_SPINAND=y
CONFIG_AW_MTD_RAWNAND=y
CONFIG_AW_SPINAND_PHYSICAL_LAYER=y
CONFIG_AW_SPINAND_NONSTANDARD_SPI_DRIVER=y
# CONFIG_AW_SPINAND_ENABLE_PHY_CRC16 is not set
# CONFIG_AW_SPINAND_PSTORE_MTD_PART is not set
CONFIG_AW_MTD_SPINAND_UBOOT_BLKS=24
# CONFIG_AW_SPINAND_SIMULATE_MULTIPLANE=y
# CONFIG_AW_MTD_SPINAND_OOB_RAW_SPARE is not set
# CONFIG_AW_RAWNAND_SIMULATE_MULTIPLANE=y

#usb otg config
CONFIG_SUNXI_USB=y
CONFIG_SUNXI_EFEX=y
CONFIG_SUNXI_BURN=y

#usb hcd
CONFIG_USB=y
CONFIG_USB_EHCI_HCD=y
CONFIG_USB_STORAGE=y
CONFIG_USB0_VBUS_PIN="PB12"
CONFIG_USB1_VBUS_PIN="PB3"

#partition
CONFIG_EFI_PARTITION=y
CONFIG_LAST_PARTITION_NAME="UDISK"
CONFIG_SUNXI_UPDATE_GPT=y

#image
CONFIG_ANDROID_BOOT_IMAGE=y

#sprite
CONFIG_SUNXI_SPRITE=y
#CONFIG_SUNXI_SECURE_STORAGE=y
CONFIG_SUNXI_SPRITE_CARTOON=y

#android
CONFIG_SUNXI_MAC=y
CONFIG_SUNXI_USER_KEY=y
CONFIG_SUNXI_AVB=y
#CONFIG_SUNXI_ANDROID_BOOT=y
CONFIG_SUNXI_SERIAL=y
CONFIG_SUNXI_VERIFY_BOOT_INFO_INSTALL=y
CONFIG_ANDROID_AB=y
CONFIG_SUNXI_RKP=y

#cmd
CONFIG_CMD_SUNXI_TIMER=y
CONFIG_CMD_SUNXI_CLK=y
CONFIG_CMD_SUNXI_SPRITE=y
CONFIG_CMD_SUNXI_EFEX=y
CONFIG_CMD_SUNXI_BURN=y
CONFIG_CMD_GPT=y
CONFIG_CMD_FAT=y
CONFIG_CMD_SUNXI_MEMTEST=y
CONFIG_CMD_FASTBOOT=y
CONFIG_CMD_PART=y
CONFIG_CMD_AB_SELECT=y
CONFIG_CMD_SUNXI_BOOTRV=y
CONFIG_CMD_SUNXI_BOOTR=y
CONFIG_CMD_USB=y
CONFIG_AIOT_DISP_PARAM_UPDATE=y
CONFIG_AIOT_DISP_PARAM_UPDATE_DEBUG=y

#dsp
CONFIG_XTENSA_DSP=y

#arisc
CONFIG_SUNXI_ARISC_EXIST=y
CONFIG_BOOT_RISCV=y
CONFIG_ARISC_DEASSERT_BEFORE_KERNEL=y

#overlay
#CONFIG_SUNXI_ANDROID_OVERLAY=y


#
# Generic Driver Options
#
CONFIG_DM=y
CONFIG_DM_WARN=y
# CONFIG_DM_DEBUG is not set
CONFIG_DM_DEVICE_REMOVE=y
CONFIG_DM_STDIO=y
CONFIG_DM_SEQ_ALIAS=y
# CONFIG_SPL_DM_SEQ_ALIAS is not set
# CONFIG_REGMAP is not set
# CONFIG_DEVRES is not set
CONFIG_SIMPLE_BUS=y
CONFIG_OF_TRANSLATE=y
CONFIG_DM_DEV_READ_INLINE=y
# CONFIG_ADC is not set
# CONFIG_ADC_EXYNOS is not set
# CONFIG_ADC_SANDBOX is not set
# CONFIG_SARADC_MESON is not set
# CONFIG_SARADC_ROCKCHIP is not set
# CONFIG_SUNXI_GPADC is not set
# CONFIG_SUNXI_LRADC is not set
# CONFIG_SATA is not set
# CONFIG_SCSI_AHCI is not set


#
# Graphics support
#
CONFIG_DM_VIDEO=y
CONFIG_BACKLIGHT_PWM=y
# CONFIG_BACKLIGHT_GPIO is not set
CONFIG_VIDEO_BPP8=y
CONFIG_VIDEO_BPP16=y
CONFIG_VIDEO_BPP32=y
CONFIG_BMP_16BPP=y
CONFIG_BMP_24BPP=y
CONFIG_BMP_32BPP=y

#
# Direct Rendering Manager
#
CONFIG_AW_DRM=y
CONFIG_AW_DRM_DE=y
CONFIG_AW_DRM_TCON=y
CONFIG_AW_DRM_TCON_TOP=y
CONFIG_AW_DRM_LVDS=y
CONFIG_AW_DRM_RGB=y
CONFIG_AW_DRM_DSI=y
CONFIG_AW_DRM_HDMI_TX=y
# CONFIG_AW_DRM_HDMI14 is not set
CONFIG_AW_DRM_HDMI20=y
# CONFIG_AW_HDMI20_HDCP14 is not set
# CONFIG_AW_HDMI20_HDCP22 is not set
# CONFIG_AW_HDMI20_CEC is not set
CONFIG_AW_DRM_EDP=y
CONFIG_AW_DRM_EDP_CONTROLLER_USED=y
# CONFIG_AW_DRM_DP_HDCP is not set
CONFIG_AW_DRM_INNO_EDP13=y
# CONFIG_AW_DRM_TRILINEAR_EDP14 is not set
# CONFIG_AW_DRM_EINK200 is not set
CONFIG_AW_DRM_PANEL=y
CONFIG_PANEL_DSI_GENERAL=y
CONFIG_PANEL_LVDS_GENERAL=y
CONFIG_PANEL_RGB_GENERAL=y
CONFIG_PANEL_EDP_GENERAL=y
CONFIG_AW_DRM_PHY=y
CONFIG_AW_DRM_DSI_COMBOPHY=y
CONFIG_VIDEO_ANSI=y
CONFIG_CONSOLE_NORMAL=y
# CONFIG_CONSOLE_ROTATION is not set
# CONFIG_CONSOLE_TRUETYPE is not set
# CONFIG_SYS_WHITE_ON_BLACK is not set
# CONFIG_NO_FB_CLEAR is not set

# Network
CONFIG_NETDEVICES=y
CONFIG_SUNXI_GMAC=y
CONFIG_NET_RANDOM_ETHADDR=y
CONFIG_CMD_NET=y
CONFIG_CMD_TFTPBOOT=y
CONFIG_NET_TFTP_VARS=y
CONFIG_CMD_MII=y
CONFIG_CMD_PING=y

#
# PHY Subsystem
#
CONFIG_PHY=y
# CONFIG_SPL_PHY is not set
# CONFIG_NOP_PHY is not set
CONFIG_MIPI_DPHY_HELPERS=y
# CONFIG_PHY_SUN4I_USB is not set
# CONFIG_MVEBU_COMPHY_SUPPORT is not set


#
# SUNXI LOGO DISPLAY
#
CONFIG_CMD_SUNXI_BMP=y
CONFIG_SUNXI_ADVERT_PICTURE=y
CONFIG_LZMA=y
# CONFIG_SUNXI_SPINOR_BMP is not set
# CONFIG_ENABLE_ADVERT_PICTURE is not set
# CONFIG_CMD_SUNXI_JPEG is not set
# CONFIG_DISP2_SUNXI is not set
#CONFIG_HDMI_DISP2_SUNXI=y
CONFIG_HDMI2_DISP2_SUNXI=y
CONFIG_INNO_PHY=y
CONFIG_HDMI20_UBOOT_DEBUG=y
# CONFIG_VDPO_DISP2_SUNXI is not set
#CONFIG_TV_DISP2_SUNXI=y
# CONFIG_DISP2_TV_GM7121 is not set
# CONFIG_DISP2_TV_AC200 is not set
# CONFIG_EDP_DISP2_SUNXI is not set
# CONFIG_EINK_PANEL_USED is not set
CONFIG_EDP2_DISP2_SUNXI=y
# CONFIG_AW_DISP2_SET_CLK_BY_IC_VERSION is not set

#
# eDP panels select
#
CONFIG_EDP2_SUPPORT_VVX10T025J00_2560X1600=y
CONFIG_EDP2_SUPPORT_GENERAL_PANEL=y

#
# eDP phy select
#
CONFIG_AW_EDP2_PHY_USED=y
CONFIG_DISP_PHY_INNO_EDP_1_3=y

#
# LCD panels select
#
CONFIG_LCD_SUPPORT_HE0801A068=n
CONFIG_LCD_SUPPORT_WILLIAMLCD=n
CONFIG_LCD_SUPPORT_LQ101R1SX03=y
CONFIG_LCD_SUPPORT_INET_DSI_PANEL=n
CONFIG_LCD_SUPPORT_CC08021801_310_800X1280=n
CONFIG_LCD_SUPPORT_T050K589=n
CONFIG_LCD_SUPPORT_KD080D24=y
CONFIG_LCD_SUPPORT_FX070_DHM18BOEL2_1024X600=n
CONFIG_LCD_SUPPORT_CC10132007_40A=n
CONFIG_LCD_SUPPORT_K101IM2QA04=n
CONFIG_LCD_SUPPORT_K101IM2BYL02L=n
CONFIG_LCD_SUPPORT_BP101WX1=y
CONFIG_LCD_SUPPORT_FX070=n
CONFIG_LCD_SUPPORT_K080_IM2HYL802R_800X1280=n
CONFIG_LCD_SUPPORT_K101_IM2BYL02_L_800X1280=n
#CONFIG_LCD_SUPPORT_GG1P4062UTSW
# CONFIG_LCD_SUPPORT_DX0960BE40A1 is not set
# CONFIG_LCD_SUPPORT_TFT720X1280 is not set
# CONFIG_LCD_SUPPORT_FD055HD003S is not set
# CONFIG_LCD_SUPPORT_ILI9341 is not set
# CONFIG_LCD_SUPPORT_LH219WQ1 is not set
# CONFIG_LCD_SUPPORT_LS029B3SX02 is not set
# CONFIG_LCD_SUPPORT_LT070ME05000 is not set
# CONFIG_LCD_SUPPORT_S6D7AA0X01 is not set
# CONFIG_LCD_SUPPORT_T27P06 is not set
# CONFIG_LCD_SUPPORT_TFT720x1280 is not set
# CONFIG_LCD_SUPPORT_WTQ05027D01 is not set
# CONFIG_LCD_SUPPORT_H245QBN02 is not set
# CONFIG_LCD_SUPPORT_ST7789V is not set
# CONFIG_LCD_SUPPORT_ST7796S is not set
# CONFIG_LCD_SUPPORT_ST7701S is not set
# CONFIG_LCD_SUPPORT_T30P106 is not set
# CONFIG_LCD_SUPPORT_TO20T20000 is not set
# CONFIG_LCD_SUPPORT_FRD450H40014 is not set
# CONFIG_LCD_SUPPORT_S2003T46G is not set
# CONFIG_LCD_SUPPORT_WTL096601G03 is not set
CONFIG_LCD_SUPPORT_CC10127007_31AB=n
#
# Display engine feature select
#
# CONFIG_DISP2_SUNXI_SUPPORT_SMBL is not set
# CONFIG_DISP2_SUNXI_SUPPORT_ENAHNCE is not set

#
# Clock
#
CONFIG_CLK_SUNXI=y
# BOOT GUI
#
CONFIG_BOOT_GUI=y
# CONFIG_UPDATE_DISPLAY_MODE is not set
# CONFIG_CONFIG_LCD_CHECK_SKIP_OPEN is not set
# CONFIG_BOOT_GUI_DOUBLE_BUF is not set
# CONFIG_BOOT_GUI_TEST is not set
CONFIG_OF_SEPARATE=y
#CONFIG_SUNXI_NECESSARY_REPLACE_FDT=y
CONFIG_SUNXI_BOOT_PARAM=y

CONFIG_PWM_SUNXI=y
CONFIG_SUNXI_WDT_V2=y

CONFIG_SUNXI_CE_30=y
CONFIG_CMD_SUNXI_CE_TEST=y
CONFIG_SUNXI_RSA_SOFTWARE=y
CONFIG_HASH=y
CONFIG_SHA256=y

CONFIG_SECURE_STORAGE_KEY_HUK=y

CONFIG_SUNXI_CE_DRIVER=y
# CONFIG_CMD_SUNXI_AUTO_FEL=y

CONFIG_SUNXI_HOMLET=y
CONFIG_SUNXI_HDCP_IN_SECURESTORAGE=y

CONFIG_SUNXI_GPIO_POWER_VOL_MODE=y
CONFIG_CMD_EXT4=y
CONFIG_BLOCK_CACHE=y
```

## configs/sun60iw2p1_a733_defconfig
```kconfig
CONFIG_SUNXI_TEXT_SIZE=0x180000
CONFIG_RESERVE_FDT_SIZE=0x80000
CONFIG_ARM=y
CONFIG_ARM_SMCCC=y
CONFIG_SYS_TEXT_BASE=0x4A000000
# CONFIG_SUNXI_SECURE_BOOT=y
CONFIG_SUNXI_WDT_V2=y
CONFIG_MACH_SUN60IW2=y
CONFIG_R_I2C0_ENABLE=y
CONFIG_USB0_VBUS_PIN="PL2"
CONFIG_USB1_VBUS_PIN="PH12"
CONFIG_DEFAULT_DEVICE_TREE="sun60iw2p1-orangepi-4-pro"
# CONFIG_CC_OPTIMIZE_FOR_SIZE is not set
# CONFIG_SYS_MALLOC_F is not set
# CONFIG_SYS_MALLOC_CLEAR_ON_INIT is not set
CONFIG_PHYS_64BIT=y
CONFIG_ANDROID_BOOT_IMAGE=y
CONFIG_SUNXI_SERIAL=y
CONFIG_ANDROID_AB=y
CONFIG_SUNXI_MAC=y
CONFIG_SUNXI_USER_KEY=y
CONFIG_SUNXI_DRM_SUPPORT=y
# CONFIG_SUNXI_ANDROID_BOOT=y
CONFIG_SUNXI_VERIFY_BOOT_INFO_INSTALL=y
# CONFIG_SUNXI_NECESSARY_REPLACE_FDT=y
CONFIG_SUNXI_HOMLET=y
CONFIG_RECOVERY_KEY=y
CONFIG_SUNXI_HDCP_IN_SECURESTORAGE=y
CONFIG_SUNXI_RKP=y
CONFIG_SUNXI_RNG_SEED=y
CONFIG_CMD_FASTBOOT=y
CONFIG_CMD_PART=y
CONFIG_CMD_USB=y
CONFIG_CMD_SUNXI_TIMER=y
CONFIG_CMD_SUNXI_SPRITE=y
CONFIG_CMD_SUNXI_BURN=y
CONFIG_CMD_SUNXI_MEMTEST=y
CONFIG_LAST_PARTITION_NAME="UDISK"
CONFIG_DM=y
CONFIG_SUNXI_GPADC=y
CONFIG_CLK_SUNXI=y
CONFIG_SUNXI_DMA=y
CONFIG_AW_GPIO_V3=y
CONFIG_SYS_I2C_SUNXI=y
CONFIG_SYS_SUNXI_R_I2C0_SLAVE=0x34
CONFIG_AXP8191_SUNXI_I2C_SLAVE=0x36
CONFIG_AXP515_SUNXI_I2C_SLAVE=0x34
CONFIG_MMC=y
CONFIG_UFS=y
CONFIG_SUNXI_POWER=y
CONFIG_SUNXI_PMU=y
CONFIG_SUNXI_BMU=y
CONFIG_AXP515_POWER=y
CONFIG_AXP8191_POWER=y
CONFIG_SUNXI_UBOOT_POWER_OFF=y
CONFIG_USB=y
CONFIG_USB_EHCI_HCD=y
CONFIG_USB_STORAGE=y
CONFIG_AW_DRM=y
CONFIG_AW_DRM_LVDS=y
CONFIG_AW_DRM_DSI=y
# CONFIG_AW_DRM_EINK200 is not set
CONFIG_AW_DRM_PANEL=y
CONFIG_PANEL_DSI_GENERAL=y
CONFIG_PANEL_LVDS_GENERAL=y
CONFIG_AW_DRM_PHY=y
CONFIG_SUNXI_SDMMC=y
CONFIG_SUNXI_BOOT0_SDMMC_BACKUP_START_ADDR=2064
CONFIG_SUNXI_UFS=y
CONFIG_SUNXI_USB=y
CONFIG_SUNXI_EFEX=y
CONFIG_SUNXI_BURN=y
CONFIG_SUNXI_CE_30=y
CONFIG_SUNXI_ARISC_EXIST=y
CONFIG_ARISC_DEASSERT_BEFORE_KERNEL=y
# CONFIG_SUNXI_ANDROID_OVERLAY=y
CONFIG_SUNXI_SPRITE=y
CONFIG_SUNXI_SPRITE_CARTOON=y
CONFIG_SUNXI_UPDATE_GPT=y
CONFIG_SUNXI_BOOT_PARAM=y
CONFIG_SUNXI_TURNNING_DRAM=y

CONFIG_ARM_SMCCC=y
CONFIG_SUNXI_DMA=y
CONFIG_PHYS_64BIT=y

CONFIG_CMD_DHCP=y
CONFIG_CMD_PXE=y

CONFIG_DISTRO_DEFAULTS=y
CONFIG_ENV_VARS_UBOOT_CONFIG=y

CONFIG_EXT4_WRITE=y
CONFIG_CMD_EXT4_WRITE=y
CONFIG_ENV_IS_IN_EXT4=y
#CONFIG_ENV_IS_IN_SUNXI_FLASH=y
```
