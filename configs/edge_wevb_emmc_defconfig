## configs/sun60iw2p1_t736_defconfig
```kconfig
CONFIG_SUNXI_TEXT_SIZE=0x150000
CONFIG_RESERVE_FDT_SIZE=0x80000
CONFIG_ARM=y
CONFIG_ARM_SMCCC=y
CONFIG_SYS_TEXT_BASE=0x4A000000
# CONFIG_SUNXI_SECURE_BOOT=y
CONFIG_SUNXI_WDT_V2=y
CONFIG_MACH_SUN60IW2=y
CONFIG_R_I2C0_ENABLE=y
CONFIG_USB0_VBUS_PIN="PL5"
CONFIG_USB1_VBUS_PIN="PL6"
CONFIG_DEFAULT_DEVICE_TREE="sun60iw2p1-soc-system"
# CONFIG_SYS_MALLOC_F is not set
# CONFIG_SYS_MALLOC_CLEAR_ON_INIT is not set
CONFIG_PHYS_64BIT=y
CONFIG_ANDROID_BOOT_IMAGE=y
CONFIG_SUNXI_SERIAL=y
CONFIG_ANDROID_AB=y
CONFIG_SUNXI_MAC=y
CONFIG_SUNXI_USER_KEY=y
CONFIG_SUNXI_DRM_SUPPORT=y
# CONFIG_SUNXI_ANDROID_BOOT=y
CONFIG_SUNXI_VERIFY_BOOT_INFO_INSTALL=y
# CONFIG_SUNXI_NECESSARY_REPLACE_FDT=y
CONFIG_SUNXI_HOMLET=y
CONFIG_RECOVERY_KEY=y
CONFIG_SUNXI_HDCP_IN_SECURESTORAGE=y
CONFIG_SUNXI_SET_EFUSE_POWER=y
CONFIG_SUNXI_RKP=y
CONFIG_CMD_FASTBOOT=y
CONFIG_CMD_PART=y
CONFIG_CMD_USB=y
CONFIG_CMD_SUNXI_TIMER=y
CONFIG_CMD_SUNXI_SPRITE=y
CONFIG_CMD_SUNXI_BURN=y
CONFIG_CMD_SUNXI_MEMTEST=y
CONFIG_DM=y
CONFIG_SUNXI_GPADC=y
CONFIG_CLK_SUNXI=y
CONFIG_SUNXI_DMA=y
CONFIG_AW_GPIO_V3=y
CONFIG_SYS_I2C_SUNXI=y
CONFIG_SYS_SUNXI_R_I2C0_SLAVE=0x34
CONFIG_AXP8191_SUNXI_I2C_SLAVE=0x36
CONFIG_AXP515_SUNXI_I2C_SLAVE=0x34
CONFIG_MMC=y
CONFIG_UFS=y
CONFIG_SPI_FLASH=y
CONFIG_SF_DEFAULT_MODE=0x3000
CONFIG_SF_DEFAULT_SPEED=20000000
CONFIG_SPI_SAMP_DL_EN=y
CONFIG_SPI_FLASH_ATMEL=y
CONFIG_SPI_FLASH_EON=y
CONFIG_SPI_FLASH_GIGADEVICE=y
CONFIG_SPI_FLASH_ISSI=y
CONFIG_SPI_FLASH_MACRONIX=y
CONFIG_SPI_FLASH_SPANSION=y
CONFIG_SPI_FLASH_STMICRO=y
CONFIG_SPI_FLASH_SST=y
CONFIG_SPI_FLASH_WINBOND=y
CONFIG_SPI_FLASH_XMC=y
CONFIG_SPI_FLASH_PUYA=y
CONFIG_SPI_FLASH_FM=y
CONFIG_SPI_FLASH_XT=y
CONFIG_AW_DWMAC=y
CONFIG_DM_ETH=y
CONFIG_SUNXI_DWMAC=y
CONFIG_SPI=y
CONFIG_SUNXI_SPI=y
CONFIG_SUNXI_POWER=y
CONFIG_SUNXI_PMU=y
CONFIG_SUNXI_BMU=y
CONFIG_AXP515_POWER=y
CONFIG_AXP8191_POWER=y
CONFIG_SUNXI_UBOOT_POWER_OFF=y
CONFIG_USB=y
CONFIG_USB_EHCI_HCD=y
CONFIG_USB_STORAGE=y
CONFIG_AW_DRM=y
CONFIG_AW_DRM_LVDS=y
CONFIG_AW_DRM_DSI=y
# CONFIG_AW_DRM_EINK200 is not set
CONFIG_AW_DRM_PANEL=y
CONFIG_PANEL_DSI_GENERAL=y
CONFIG_PANEL_LVDS_GENERAL=y
CONFIG_AW_DRM_PHY=y
CONFIG_SPINOR_LOGICAL_OFFSET=3296
CONFIG_SPINOR_UBOOT_OFFSET=512
CONFIG_SUNXI_SDMMC=y
CONFIG_SUNXI_BOOT0_SDMMC_BACKUP_START_ADDR=2064
CONFIG_SUNXI_USB=y
CONFIG_SUNXI_EFEX=y
CONFIG_SUNXI_BURN=y
CONFIG_SUNXI_CE_30=y
CONFIG_SUNXI_PHY_KEY=y
CONFIG_SUNXI_LRADC_KEY=y
CONFIG_SUNXI_ARISC_EXIST=y
CONFIG_ARISC_DEASSERT_BEFORE_KERNEL=y
CONFIG_HWSPINLOCK=y
CONFIG_CMD_SUNXI_HWSPINLOCK=y
# CONFIG_SUNXI_ANDROID_OVERLAY=y
CONFIG_SUNXI_SPRITE=y
CONFIG_SUNXI_SPRITE_CARTOON=y
CONFIG_SUNXI_SPRITE_LED=y
CONFIG_SUNXI_UPDATE_GPT=y
CONFIG_SUNXI_BOOT_PARAM=y
CONFIG_SUNXI_TURNNING_DRAM=y

CONFIG_ARM_SMCCC=y
CONFIG_SUNXI_DMA=y
CONFIG_PHYS_64BIT=y

CONFIG_CMD_DHCP=y
CONFIG_CMD_PXE=y

CONFIG_DISTRO_DEFAULTS=y
CONFIG_ENV_VARS_UBOOT_CONFIG=y

CONFIG_EXT4_WRITE=y
CONFIG_CMD_EXT4_WRITE=y
CONFIG_ENV_IS_IN_EXT4=y
#CONFIG_ENV_IS_IN_SUNXI_FLASH=y

#CONFIG_CMD_SF=y
#
##cmd
#CONFIG_CMD_NVME=y
#CONFIG_CMD_PCI=y
##nvme
#CONFIG_NVME=y
##pci
#CONFIG_PCI=y
#CONFIG_DM_PCI=y
#CONFIG_PCIE_ALLWINNER_RC=y
##pcie phy
##CONFIG_AW_INNO_COMBOPHY=y
#CONFIG_AW_CADENCE_COMBOPHY=y
#
#CONFIG_CMD_NVME=y
#CONFIG_CMD_PCI=y
#CONFIG_AW_BLK=y
#CONFIG_NVME=y
#CONFIG_PCI=y
#CONFIG_DM_PCI=y
#CONFIG_PCIE_ALLWINNER_RC=y
#CONFIG_PCIE_PERST_GPIO="PD22"
#CONFIG_PCIE_WAKE_GPIO="PD21"
#CONFIG_PCIE_POWER_GPIO="PL3"
#CONFIG_AW_CADENCE_COMBOPHY=y
```

## drivers/crypto/Kconfig
```kconfig
menu "Hardware crypto devices"

source drivers/crypto/fsl/Kconfig

config SOPHON_SPACC_SHA
        bool "sophon spacc sha"
        help
          Select Crypto driver for sophon platfrom

config SOPHON_SPACC_aes
        bool "sophon spacc aes"
        help
          Select Crypto driver for sophon platfromd

endmenu
```
