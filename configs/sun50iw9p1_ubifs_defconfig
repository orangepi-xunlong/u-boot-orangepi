## drivers/phy/allwinner/Kconfig
```kconfig
#
# Phy drivers for Allwinner platforms
#
config PHY_SUN4I_USB
	bool "Allwinner Sun4I USB PHY driver"
	depends on ARCH_SUNXI
	select PHY
	help
	  Enable this to support the transceiver that is part of Allwinner
	  sunxi SoCs.

	  This driver controls the entire USB PHY block, both the USB OTG
	  parts, as well as the 2 regular USB 2 host PHYs.

config AW_INNO_COMBOPHY
	tristate "Allwinner INNO COMBO PHY Driver"
	default n
	depends on ARCH_SUNXI
	help
	  Enable this to support the Allwinner PCIe/USB3.0 combo PHY
	  with INNOSILICON IP block.

config AW_CADENCE_COMBOPHY
	bool "Allwinner CADENCE COMBO PHY Driver"
	default n
	depends on ARCH_SUNXI
	select PHY
	help
	  Enable this to support the Allwinner PCIe/USB3.0/DisplayPort combo PHY
	  with CADENCE IP block.
```

## drivers/phy_key/Kconfig
```kconfig
menuconfig SUNXI_PHY_KEY
	bool "Sunxi phy-key divice support"

if SUNXI_PHY_KEY

choice
	prompt "choice sunxi phy-key"
	default SUNXI_GPADC_KEY
	default SUNXI_LRADC_KEY

config SUNXI_GPADC_KEY
	bool "Support sunxi gpkey devices"
	help
	  Enable support for sunxi gpkey devices.

config SUNXI_LRADC_KEY
	bool "Support sunxi lrkey devices"
	help
	  Enable support for sunxi lrkey devices.
endchoice

endif
```

## drivers/ram/starfive/Kconfig
```kconfig
config SPL_STARFIVE_DDR
	bool "STARFive DDR driver in SPL"
	depends on SPL_RAM && STARFIVE_JH7110
	help
	  This enables DDR support for the platforms based on StarFive SoC.

choice
	prompt "DDR working frequency"
	depends on SPL_STARFIVE_DDR
	default STARFIVE_DDR_2133
	help
	  choice DDR working frequency(Default is 2133M).

	config STARFIVE_DDR_2133
		bool "Frequency of DDR is 2133M"
	config STARFIVE_DDR_2800
		bool "Frequency of DDR is 2800M"
	config STARFIVE_DDR_3200
		bool "Frequency of DDR is 3200M"

endchoice
```

## drivers/smc/Kconfig
```kconfig
menu "OPTEE_VERSION"

choice
	prompt "select optee version"
	default OPTEE25 if MACH_SUN8IW18

config OPTEE25
	bool "use optee 2.5 smc api"
	---help---
	Select this to use optee 2.5 smc api.

config NOT_USE_OPTEE25
	bool "no use optee 2.5 smc api"
	---help---
	Select this to no use optee 2.5 smc api.
endchoice

endmenu
```

## drivers/sunxi_crypto/Kconfig
```kconfig
menu "Sunxi crypto driver support"

config SUNXI_CE_DRIVER
	bool "Sunxi ce driver support"

choice
	prompt "CE_VERSION"
	depends on SUNXI_CE_DRIVER
config SUNXI_CE_10
	bool "CE_VERSION 1.0"

config SUNXI_CE_20
	bool "CE_VERSION 2.0"

config SUNXI_CE_21
	bool "CE_VERSION 2.1"

config SUNXI_CE_23
	bool "CE_VERSION 2.3"
endchoice

config SUNXI_SHA_CAL_PADDING
	int "padding when malloc buffer for sha calculation"
	depends on SUNXI_CE_DRIVER
	default 0 if SUNXI_CE_20 || SUNXI_CE_21 || SUNXI_CE_23
	default 64 if SUNXI_CE_10
	help
		some version of ce need to add padding data
		to target data tail when calculating sha, even
		when data len is already aligned. if malloc size
		equals data len, padding goes to success buffer,
		result in heap overflow. count this size in when
		malloc buffer for sha calculation

endmenu
```

## drivers/sunxi_flash/Kconfig
```kconfig
menuconfig SUNXI_FLASH
	bool "Sunxi flash support"

if SUNXI_FLASH

source "drivers/sunxi_flash/nand/Kconfig"
source "drivers/sunxi_flash/spinor/Kconfig"
source "drivers/sunxi_flash/mmc/Kconfig"

endif
```

## drivers/sunxi_flash/mmc/Kconfig
```kconfig
config SUNXI_SDMMC
	bool "support sunxi sdmmc devices"
	depends on SUNXI_FLASH && MMC
	default n
	help
	  enable support for sunxi sdmmc devices. these provide a block-level interface which permits
	  reading, writing and (in some cases) erasing blocks.


if SUNXI_SDMMC
config MMC_LOGICAL_OFFSET
	int "logic address for read/write"
	default 40960
	help
	  logic address for mbr and partitions(1M-MBRSIZE = 2048-32).
	  SDMMC address is offset*512 bytes.

config SUNXI_BOOT0_SDMMC_BACKUP_START_ADDR
	int "backup boot0 offset"
	default 256
	help
	  offset to write backup boot0, unit:sector(512 bytes)

config SUNXI_RECOVERY_BOOT0_COPY0
	bool "recovery boot0 copy 0 on boot"
	default n
	help
	  check if boot from copy1, if so, copy0 is curruptted.
	  copy copy1 to copy0 to recovery it

endif
```
