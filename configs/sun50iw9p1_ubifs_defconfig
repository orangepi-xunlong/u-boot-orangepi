## configs/sun8iw20p1_rtos_nor_defconfig
```kconfig
CONFIG_ARM=y
CONFIG_ARCH_SUNXI=y
CONFIG_MACH_SUN8IW20=y
CONFIG_SUNXI_GPIO_V2=y
#CONFIG_AXP_GPIO=y
CONFIG_SYS_CONFIG_NAME="sun8iw20p1"
CONFIG_DEFAULT_DEVICE_TREE="sun8iw20p1-soc-system"
# CONFIG_SYS_MALLOC_CLEAR_ON_INIT is not set
CONFIG_CONSOLE_MUX=y
CONFIG_SUNXI_NECESSARY_REPLACE_FDT=y
CONFIG_RESERVE_FDT_SIZE=0x20000
CONFIG_PRE_CONSOLE_BUFFER=n
# CONFIG_OF_BOARD=y
CONFIG_OF_SEPARATE=y
CONFIG_SYS_TEXT_BASE=0x43000000
CONFIG_SUNXI_FDT_ADDR=0x41800000

# Environment
CONFIG_ENV_IS_IN_SUNXI_FLASH=y
CONFIG_SYS_MAXARGS=64
#CONFIG_SUNXI_REDUNDAND_ENVIRONMENT=y
#CONFIG_SYS_REDUNDAND_ENVIRONMENT=y
CONFIG_SUNXI_ENV_PARTITION="env"
#CONFIG_SUNXI_ENV_REDUNDAND_PARTITION="env-redund"
#CONFIG_ENV_SIZE=0x20000

#system
CONFIG_ARM_SMCCC=y
CONFIG_SUNXI_DMA=y

#axp
#CONFIG_R_I2C0_ENABLE=y
#CONFIG_SYS_SUNXI_R_I2C0_SLAVE=0x34
#CONFIG_SYS_SUNXI_R_I2C0_SPEED=400000
#CONFIG_SUNXI_POWER=y
#CONFIG_SUNXI_PMU=y
#CONFIG_SUNXI_BMU=y
#CONFIG_AXP2585_POWER=y

#key
#CONFIG_SUNXI_PHY_KEY=y
#CONFIG_SUNXI_LRADC_KEY=y

# flash
CONFIG_SUNXI_FLASH=y
#CONFIG_SUNXI_UBIFS=y
CONFIG_SUNXI_SPINOR=y
CONFIG_SUNXI_NOR_IMG=y

#SPI
CONFIG_SPI=y
CONFIG_SUNXI_SPI=y
CONFIG_SPI_FLASH=y
CONFIG_SPI_FLASH_WINBOND=y
CONFIG_SPI_FLASH_EON=y
CONFIG_SPI_FLASH_GIGADEVICE=y
CONFIG_SPI_FLASH_ISSI=y
CONFIG_SPI_FLASH_MACRONIX=y
CONFIG_SPI_FLASH_SPANSION=y
CONFIG_SPI_FLASH_ATMEL=y
CONFIG_SPI_FLASH_STMICRO=y
CONFIG_SPI_FLASH_SST=y
CONFIG_SPI_FLASH_PUYA=y
CONFIG_SPI_FLASH_FM=y
CONFIG_SPI_FLASH_XT=y
CONFIG_SPI_FLASH_ADESTO=y
CONFIG_SPI_FLASH_XMC=y

# BIT(12) BIT(13) (SPI_RX_DUAL|SPI_RX_QUAD)
CONFIG_SF_DEFAULT_MODE=0x3000
CONFIG_SF_DEFAULT_SPEED=50000000
CONFIG_SPINOR_UBOOT_OFFSET=128

CONFIG_SUNXI_RTOS=y
CONFIG_SUNXI_RTOS_OFFSET1_ENABLE=n
CONFIG_SUNXI_RTOS_OFFSET2_ENABLE=n
CONFIG_SUNXI_RTOS_LOGICAL_OFFSET=96

#usb otg config
CONFIG_SUNXI_USB=y
CONFIG_SUNXI_EFEX=y
#CONFIG_SUNXI_BURN=y
CONFIG_SUNXI_FASTBOOT=y
#partition
CONFIG_EFI_PARTITION=y

#image
CONFIG_ANDROID_BOOT_IMAGE=y

#secure
CONFIG_SUNXI_EXTERN_SECURE_MM_LAYOUT=y

#sprite
CONFIG_SUNXI_SPRITE=y
#CONFIG_SUNXI_SECURE_STORAGE=y

#cmd
CONFIG_CMD_SUNXI_TIMER=y
CONFIG_CMD_SUNXI_SPRITE=y
CONFIG_CMD_SUNXI_EFEX=y
CONFIG_CMD_SUNXI_BURN=y
CONFIG_CMD_GPT=y
CONFIG_CMD_FAT=y
CONFIG_CMD_FASTBOOT=y
CONFIG_CMD_PART=y
CONFIG_CMD_SUNXI_BOOTR=y

#
# SUNXI LOGO DISPLAY
#
CONFIG_CMD_SUNXI_BMP=y
#CONFIG_SUNXI_ADVERT_PICTURE=y
CONFIG_LZMA=y
# CONFIG_SUNXI_SPINOR_BMP is not set
# CONFIG_ENABLE_ADVERT_PICTURE is not set
# CONFIG_CMD_SUNXI_JPEG is not set
CONFIG_DISP2_SUNXI=y
# CONFIG_HDMI_DISP2_SUNXI is not set
CONFIG_HDMI2_DISP2_SUNXI=y
# CONFIG_DEFAULT_PHY is not set
CONFIG_AW_PHY=y
# CONFIG_HDMI2_HDCP_SUNXI is not set
# CONFIG_HDMI2_CEC_SUNXI is not set
# CONFIG_HDMI2_FREQ_SPREAD_SPECTRUM is not set
# CONFIG_VDPO_DISP2_SUNXI is not set
#CONFIG_TV_DISP2_SUNXI=y
# CONFIG_DISP2_TV_GM7121 is not set
# CONFIG_DISP2_TV_AC200 is not set
# CONFIG_EDP_DISP2_SUNXI is not set
# CONFIG_EINK_PANEL_USED is not set

# BOOT GUI
#
CONFIG_BOOT_GUI=y
# CONFIG_UPDATE_DISPLAY_MODE is not set
# CONFIG_CONFIG_LCD_CHECK_SKIP_OPEN is not set
# CONFIG_BOOT_GUI_DOUBLE_BUF is not set
# CONFIG_BOOT_GUI_TEST is not set
#
# Serial drivers
#CONFIG_BAUDRATE=115200
#CONFIG_SPECIFY_CONSOLE_INDEX=y
#CONFIG_CONS_INDEX=1

CONFIG_SUNXI_SRAM_BOOTMODE=y
```

## configs/sun8iw21p1_ft_defconfig
```kconfig
CONFIG_ARM=y
CONFIG_ARCH_SUNXI=y
CONFIG_MACH_SUN8IW21=y
CONFIG_SUNXI_GPIO_V2=y
#CONFIG_AXP_GPIO=y
CONFIG_SYS_CONFIG_NAME="sun8iw21p1"
CONFIG_DEFAULT_DEVICE_TREE="sun8iw21p1-soc-system"
# CONFIG_SYS_MALLOC_CLEAR_ON_INIT is not set
CONFIG_CONSOLE_MUX=y
CONFIG_SUNXI_NECESSARY_REPLACE_FDT=y
CONFIG_RESERVE_FDT_SIZE=0x20000
CONFIG_PRE_CONSOLE_BUFFER=n
# CONFIG_OF_BOARD=y
CONFIG_OF_SEPARATE=y
CONFIG_SYS_TEXT_BASE=0x43000000
CONFIG_SUNXI_FDT_ADDR=0x41800000

# Environment
# CONFIG_ENV_IS_IN_SUNXI_FLASH=y
# CONFIG_SYS_MAXARGS=64
# CONFIG_SUNXI_REDUNDAND_ENVIRONMENT=y
# CONFIG_SYS_REDUNDAND_ENVIRONMENT=y
# CONFIG_SUNXI_ENV_PARTITION="env"
CONFIG_SUNXI_ENV_BACKUP=y
# CONFIG_SUNXI_ENV_REDUNDAND_PARTITION="env-redund"
# CONFIG_ENV_SIZE=0x20000

#system
CONFIG_ARM_SMCCC=y
CONFIG_SUNXI_DMA=y
CONFIG_CLK_SUNXI=y

CONFIG_SF_DEFAULT_SPEED=50000000
# BIT(12) BIT(13) (SPI_RX_DUAL|SPI_RX_QUAD)
CONFIG_SF_DEFAULT_MODE=0x3000
CONFIG_SPINOR_UBOOT_OFFSET=128
CONFIG_SPINOR_LOGICAL_OFFSET=2016


#axp
CONFIG_SYS_I2C_SUNXI=y
CONFIG_I2C1_ENABLE=y
CONFIG_SYS_SUNXI_I2C1_SLAVE=0x34
CONFIG_SYS_SUNXI_I2C1_SPEED=400000
CONFIG_SUNXI_POWER=y
CONFIG_SUNXI_PMU=y
CONFIG_AXP2101_POWER=y
CONFIG_AXP2101_SUNXI_I2C_SLAVE=0x34


#key
#CONFIG_SUNXI_PHY_KEY=y
#CONFIG_SUNXI_LRADC_KEY=y


#crypto driver
#CONFIG_SF_DEFAULT_SPEED=50000000
# BIT(12) BIT(13) (SPI_RX_DUAL|SPI_RX_QUAD)
#CONFIG_SF_DEFAULT_MODE=0x3000

#
# PWM_SUNXI
#
CONFIG_PWM_SUNXI=y
# CONFIG_PWM_SUNXI_NEW is not set

#CONFIG_SPINOR_UBOOT_OFFSET=128
#CONFIG_SPINOR_LOGICAL_OFFSET=2016

# flash
CONFIG_SUNXI_SDMMC=y
CONFIG_MMC=y
CONFIG_SUNXI_FLASH=y

#usb otg config
CONFIG_SUNXI_USB=y
CONFIG_SUNXI_EFEX=y
CONFIG_SUNXI_BURN=y
CONFIG_SUNXI_FASTBOOT=y
#partition
CONFIG_EFI_PARTITION=y

#image
CONFIG_ANDROID_BOOT_IMAGE=y

#sprite
CONFIG_SUNXI_SPRITE=y
CONFIG_SUNXI_SECURE_STORAGE=y
CONFIG_SUNXI_SPRITE_CARTOON=y

#secure feature
CONFIG_SUNXI_SECURE_BOOT=y
CONFIG_SUNXI_IMAGE_VERIFIER=y
CONFIG_SUNXI_KEYBOX=y
CONFIG_SUNXI_DRM_SUPPORT=y
CONFIG_SUNXI_EXTERN_SECURE_MM_LAYOUT=y


CONFIG_SUNXI_HOMLET=y
CONFIG_SUNXI_HDCP_HASH=y
CONFIG_SUNXI_HDCP_IN_SECURESTORAGE=y

#cmd
CONFIG_CMD_SUNXI_TIMER=y
CONFIG_CMD_SUNXI_SPRITE=y
CONFIG_CMD_SUNXI_EFEX=y
CONFIG_CMD_SUNXI_BURN=y
CONFIG_CMD_GPT=y
CONFIG_CMD_FAT=y
CONFIG_CMD_FASTBOOT=y
CONFIG_CMD_SUNXI_DMA=y
CONFIG_CMD_SUNXI_CLK=y
CONFIG_CMD_SUNXI_MEMTEST=y
CONFIG_CMD_PART=y
CONFIG_CMD_SUNXI_AUTO_FEL=n
CONFIG_CMD_SUNXI_BOOTR=y
#arisc
#CONFIG_SUNXI_ARISC_EXIST=y

# CONFIG_SUNXI_INITRD_ROUTINE is not set
#dsp
#CONFIG_XTENSA_DSP=y
#riscv
#CONFIG_RISCV_E907=y
```

## configs/sun8iw7p1_defconfig
```kconfig
CONFIG_ARM=y
CONFIG_ARCH_SUNXI=y
CONFIG_MACH_SUN8IW7=y
CONFIG_DEFAULT_DEVICE_TREE="sun8iw7p1-soc"
# CONFIG_SYS_MALLOC_CLEAR_ON_INIT is not set
CONFIG_CONSOLE_MUX=y
CONFIG_PRE_CONSOLE_BUFFER=n
CONFIG_OF_BOARD=y
#CONFIG_OF_SEPARATE=y
CONFIG_SYS_TEXT_BASE=0x4A000000
CONFIG_SUNXI_FDT_ADDR=0x44000000

#system
CONFIG_ARM_SMCCC=y
CONFIG_SUNXI_DMA=y

#
# PWM_SUNXI
#
# CONFIG_PWM_SUNXI is not set
CONFIG_PWM_SUNXI_NEW=y

# flash
CONFIG_SUNXI_FLASH=y
CONFIG_SUNXI_NAND=y
CONFIG_SUNXI_COMM_NAND_V1=y

# mmc
CONFIG_MMC=y
CONFIG_MMC_SUNXI=y
CONFIG_MMC_SUNXI_HAS_NEW_MODE=y
CONFIG_SUNXI_SDMMC=y

#usb otg config
CONFIG_SUNXI_USB=y
CONFIG_SUNXI_EFEX=y
CONFIG_SUNXI_BURN=y
CONFIG_SUNXI_FASTBOOT=y
#partition
CONFIG_EFI_PARTITION=y

#image
CONFIG_ANDROID_BOOT_IMAGE=y

#sprite
CONFIG_SUNXI_SPRITE=y
CONFIG_SUNXI_SECURE_STORAGE=y

#secure feature
CONFIG_SUNXI_SECURE_BOOT=y
CONFIG_SUNXI_KEYBOX=y

#cmd
CONFIG_CMD_SUNXI_TIMER=y
CONFIG_CMD_SUNXI_SPRITE=y
CONFIG_CMD_SUNXI_EFEX=y
CONFIG_CMD_SUNXI_BURN=y
CONFIG_CMD_GPT=y
CONFIG_CMD_FAT=y
CONFIG_CMD_FASTBOOT=y
CONFIG_CMD_SUNXI_DMA=y
CONFIG_CMD_PART=y

#android
CONFIG_SUNXI_USER_KEY=y
CONFIG_SUNXI_ANDROID_BOOT=y
CONFIG_SUNXI_AVB=y
CONFIG_SUNXI_MAC=y
CONFIG_SUNXI_SERIAL=y

#homlet
CONFIG_SUNXI_HOMLET=y
CONFIG_SUNXI_BOX_STANDBY=y
CONFIG_IR_BOOT_RECOVERY=y
CONFIG_SUNXI_DRM_SUPPORT=y
CONFIG_SUNXI_HDCP_IN_SECURESTORAGE=y
CONFIG_SUNXI_HDCP_HASH=y

#
# Clock
#
CONFIG_CLK_SUNXI=y
#
# BOOT GUI
#
CONFIG_BOOT_GUI=y
# CONFIG_UPDATE_DISPLAY_MODE is not set
# CONFIG_CONFIG_LCD_CHECK_SKIP_OPEN is not set
# CONFIG_BOOT_GUI_DOUBLE_BUF is not set
# CONFIG_BOOT_GUI_TEST is not set

#
# SUNXI LOGO DISPLAY
#
CONFIG_CMD_SUNXI_BMP=y
CONFIG_SUNXI_ADVERT_PICTURE=y
CONFIG_LZMA=y
# CONFIG_SUNXI_SPINOR_BMP is not set
# CONFIG_ENABLE_ADVERT_PICTURE is not set
# CONFIG_CMD_SUNXI_JPEG is not set
CONFIG_DISP2_SUNXI=y
CONFIG_HDMI_DISP2_SUNXI=y
# CONFIG_HDMI2_DISP2_SUNXI is not set
# CONFIG_VDPO_DISP2_SUNXI is not set
CONFIG_TV_DISP2_SUNXI=y
# CONFIG_DISP2_TV_GM7121 is not set
# CONFIG_DISP2_TV_AC200 is not set
# CONFIG_EDP_DISP2_SUNXI is not set
# CONFIG_EINK_PANEL_USED is not set

#
# LCD panels select
#
# CONFIG_LCD_SUPPORT_GG1P4062UTSW is not set
# CONFIG_LCD_SUPPORT_DX0960BE40A1 is not set
# CONFIG_LCD_SUPPORT_TFT720X1280 is not set
# CONFIG_LCD_SUPPORT_FD055HD003S is not set
# CONFIG_LCD_SUPPORT_HE0801A068 is not set
# CONFIG_LCD_SUPPORT_ILI9341 is not set
# CONFIG_LCD_SUPPORT_LH219WQ1 is not set
# CONFIG_LCD_SUPPORT_LS029B3SX02 is not set
# CONFIG_LCD_SUPPORT_LT070ME05000 is not set
# CONFIG_LCD_SUPPORT_S6D7AA0X01 is not set
# CONFIG_LCD_SUPPORT_T27P06 is not set
# CONFIG_LCD_SUPPORT_TFT720x1280 is not set
# CONFIG_LCD_SUPPORT_WTQ05027D01 is not set
# CONFIG_LCD_SUPPORT_H245QBN02 is not set
# CONFIG_LCD_SUPPORT_ST7789V is not set
# CONFIG_LCD_SUPPORT_ST7796S is not set
# CONFIG_LCD_SUPPORT_ST7701S is not set
# CONFIG_LCD_SUPPORT_T30P106 is not set
# CONFIG_LCD_SUPPORT_TO20T20000 is not set
# CONFIG_LCD_SUPPORT_FRD450H40014 is not set
# CONFIG_LCD_SUPPORT_S2003T46G is not set
# CONFIG_LCD_SUPPORT_WILLIAMLCD is not set
# CONFIG_LCD_SUPPORT_LQ101R1SX03 is not set
# CONFIG_LCD_SUPPORT_INET_DSI_PANEL is not set
# CONFIG_LCD_SUPPORT_WTL096601G03 is not set

#
# Display engine feature select
#
# CONFIG_DISP2_SUNXI_SUPPORT_SMBL is not set
# CONFIG_DISP2_SUNXI_SUPPORT_ENAHNCE is not set
```

## drivers/arisc/Kconfig
```kconfig
config SUNXI_ARISC_EXIST
	bool "support sunxi arisc"
	default n

config ARISC_DEASSERT_BEFORE_KERNEL
	bool "sunxi arisc deassert before kernel"
	default n
```

## drivers/clk/starfive/Kconfig
```kconfig
# SPDX-License-Identifier: GPL-2.0

config SPL_CLK_JH7110
	bool "SPL clock support for JH7110"
	depends on STARFIVE_JH7110 && SPL
	select SPL_CLK
	select SPL_CLK_CCF
	help
	  This enables SPL DM/DTS support for clock driver in JH7110

config CLK_JH7110
	bool "Starfive JH7110 clock support"
	depends on CLK && CLK_CCF && STARFIVE_JH7110
	help
	  This enables support clock driver for Starfive JH7110 SoC platform.
```

## drivers/mtd/aw-spinand/Kconfig
```kconfig
config AW_SPINAND_PHYSICAL_LAYER
	bool
	help
	  Enable support for Allwinner's physical layer for spinand.
	  It's a command physical layer, used by both AW-nand with nftl and
	  MTD-nand with ubi.

config AW_SPINAND_NONSTANDARD_SPI_DRIVER
	bool
	help
	  Use NONSTANDARD spi controller driver for spinand. It's mamy
	  bugs on standard spi driver when we developing, that's why the
	  nonstandard spi driver existed.

config AW_SPINAND_ENABLE_PHY_CRC16
	bool "check crc16 for each page on spinand physical layer"
	depends on AW_SPINAND_PHYSICAL_LAYER
	help
	  It is experimental.
	  To check crc16 for each page on spinand physical layer.

config AW_MTD_SPINAND
	tristate "Allwinner MTD SPINAND Device Support"
	depends on ARCH_SUNXI
	select AW_SPINAND_PHYSICAL_LAYER
	select AW_SPINAND_NONSTANDARD_SPI_DRIVER
	select MTD_UBI
	help
	  Enables support for SPINAND Flash chips on Allwinner SoCs.
	  It's different with Allwinner's privately nand driver that it use
	  ubi system rather than Allwinner's NFTL.

config AW_SPINAND_PSTORE_MTD_PART
	bool "create pstore mtd partition for aw ubi spinand"
	depends on AW_MTD_SPINAND
	help
	  Whether create pstore mtd partition, which is need by pstroe-blk.
	  If you want linux kernel dump log to spinand when oops/panic, you
	  should create pstreo mtd partition by this configure.

	  If unsure, say no.

config AW_MTD_SPINAND_UBOOT_BLKS
	int "Blocks Count Reserved For Uboot"
	depends on AW_MTD_SPINAND
	default 0
	range 0 33
	help
	  How many reserved blocks for uboot and uboot's copy?
	  It's must in range [1,33]. If 0, set it automatically.
	  The larger it is, the more uboot copies to save.

	  WARNING!!!
	  If it is change, the secure storage may be erased!
	  Once changed, the image will be incompatible to old image.

	  if unsure, set it 0.
```

## drivers/mtd/awnand/Kconfig
```kconfig
menu "sunxi-nand"
choice
	prompt "AWNAND CHOICE"
	default AW_MTD_RAWNAND
	optional

config AW_MTD_SPINAND
	tristate "Allwinner MTD SPINAND Device Support"
	depends on ARCH_SUNXI
	select AW_SPINAND_PHYSICAL_LAYER
	select AW_SPINAND_NONSTANDARD_SPI_DRIVER
	select MTD_UBI
	select MTD_DEVICE
	select MTD_PARTITIONS
	select MTD_CMD_MTDPARTS
	select MTD_CMD_UBIFS
	select CMD_UBI
	select RBTREE
	select LZO
	help
	  Enables support for SPINAND Flash chips on Allwinner SoCs.
	  It's different with Allwinner's privately nand driver that it use
	  ubi system rather than Allwinner's NFTL.

config AW_MTD_RAWNAND
	tristate "Allwinner MTD RAWNAND(SLC) Device Support"
	depends on ARCH_SUNXI
	select SUNXI_UBIFS
	select SUNXI_NAND
	select SUNXI_COMM_NAND_V1
	select MTD_DEVICE
	select CMD_MTDPARTS
	select CMD_UBIFS
	select CMD_UBI
	select RBTREE
	select LZO
	help
	  Enables support for RAWNAND Flash chips on Allwinner SoCs.
	  It's different with Allwinner's privately nand driver that it use
	  ubi system rather than Allwinner's NFTL.
endchoice

source "drivers/mtd/awnand/spinand/Kconfig"
source "drivers/mtd/awnand/rawnand/Kconfig"
endmenu
```

## drivers/mtd/awnand/spinand/Kconfig
```kconfig
config AW_SPINAND_PHYSICAL_LAYER
	bool
	help
	  Enable support for Allwinner's physical layer for spinand.
	  It's a command physical layer, used by both AW-nand with nftl and
	  MTD-nand with ubi.

config AW_SPINAND_NONSTANDARD_SPI_DRIVER
	bool
	help
	  Use NONSTANDARD spi controller driver for spinand. It's mamy
	  bugs on standard spi driver when we developing, that's why the
	  nonstandard spi driver existed.

config AW_SPINAND_ENABLE_PHY_CRC16
	bool "check crc16 for each page on spinand physical layer"
	depends on AW_SPINAND_PHYSICAL_LAYER
	help
	  It is experimental.
	  To check crc16 for each page on spinand physical layer.

config AW_SPINAND_PSTORE_MTD_PART
	bool "create pstore mtd partition for aw ubi spinand"
	depends on AW_MTD_SPINAND
	help
	  Whether create pstore mtd partition, which is need by pstroe-blk.
	  If you want linux kernel dump log to spinand when oops/panic, you
	  should create pstreo mtd partition by this configure.

	  If unsure, say no.

config AW_MTD_SPINAND_UBOOT_BLKS
	int "Blocks Count Reserved For Uboot"
	depends on AW_MTD_SPINAND
	default 24
	range 0 33
	help
	  How many reserved blocks for uboot and uboot's copy?
	  It's must in range [1,33]. If 0, set it automatically.
	  The larger it is, the more uboot copies to save.

	  WARNING!!!
	  If it is change, the secure storage may be erased!
	  Once changed, the image will be incompatible to old image.

	  if unsure, set it 0.

config AW_SPINAND_SIMULATE_MULTIPLANE
	bool "enable simulate multiplane"
	depends on AW_SPINAND_PHYSICAL_LAYER
	default y
	help
	  spinand do not support multiplane. In order to adapt to aw nand
	  we simulate multiplane. If set, the common physical layer should
	  merge two continuous physical block to 'super block' for logical
	  layer.

	  Merge pages in two adjacent blocks with the same page num to super
	  page. Merge adjacent blocks to super block.

	  *   phy-block0   phy-block1    = super block 0
	  * |------------|------------|
	  * | phy-page 0 | phy-page 0 |  = super page 0 on super block 0
	  * | phy-page 1 | phy-page 1 |  = super page 1 on super block 0
	  * |     ...    |     ...    |
	  * |------------|------------|

	  If unsure, say Y.

config AW_MTD_SPINAND_OOB_RAW_SPARE
	bool "support mtd read oob raw spare data"
	depends on AW_MTD_SPINAND
	default n
	help
		aw spinand do not support read raw spare data by default, say yes to
		support mtd read oob raw spare data.

		if enable AW_MTD_SPINAND_OOB_RAW_SPARE, the oob is equivalent to spare area,
		otherwise oob is the user data spare area in ecc protected.
```
