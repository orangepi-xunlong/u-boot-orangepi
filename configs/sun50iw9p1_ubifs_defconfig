## configs/sun8iw15p1_defconfig
```kconfig
CONFIG_ARM=y
CONFIG_ARCH_SUNXI=y
CONFIG_MACH_SUN8IW15=y
#CONFIG_AXP_GPIO=y
CONFIG_DEFAULT_DEVICE_TREE="sun8iw15-common"
# CONFIG_SYS_MALLOC_CLEAR_ON_INIT is not set
CONFIG_CONSOLE_MUX=y
CONFIG_OF_BOARD=y
CONFIG_SYS_TEXT_BASE=0x4A000000

#system
CONFIG_ARM_SMCCC=y
CONFIG_SUNXI_DMA=y

# flash
CONFIG_SUNXI_SDMMC=y
CONFIG_MMC=y
CONFIG_SUNXI_FLASH=y
CONFIG_SUNXI_NAND=n

#usb otg config
CONFIG_SUNXI_USB=y
CONFIG_SUNXI_EFEX=y
CONFIG_SUNXI_BURN=y

#partition
CONFIG_EFI_PARTITION=y

#image
CONFIG_ANDROID_BOOT_IMAGE=y

#sprite
CONFIG_SUNXI_SPRITE=y
CONFIG_SUNXI_SECURE_STORAGE=y

#power
CONFIG_SUNXI_POWER=y
CONFIG_SUNXI_PMU=y
CONFIG_SUNXI_BMU=y
CONFIG_AXPNULL_POWER=y
CONFIG_AXP858_POWER=y
CONFIG_AXP2585_POWER=y
#cmd
CONFIG_CMD_SUNXI_TIMER=y
CONFIG_CMD_SUNXI_SPRITE=y
CONFIG_CMD_SUNXI_EFEX=y
CONFIG_CMD_SUNXI_BURN=y
CONFIG_CMD_GPT=y
CONFIG_CMD_FAT=y
CONFIG_CMD_PART=y
```

## configs/sun8iw16p1_nor_defconfig
```kconfig
CONFIG_ARM=y
CONFIG_ARCH_SUNXI=y
CONFIG_MACH_SUN8IW16=y
#CONFIG_AXP_GPIO=y
CONFIG_DEFAULT_DEVICE_TREE="sun8iw16-common"
# CONFIG_SYS_MALLOC_CLEAR_ON_INIT is not set
CONFIG_CONSOLE_MUX=y
CONFIG_OF_BOARD=y
CONFIG_SYS_TEXT_BASE=0x43100000

#device tree address for kernel
CONFIG_SUNXI_FDT_ADDR=0x43000000

#system
CONFIG_ARM_SMCCC=y
#CONFIG_SUNXI_DEBUG=y
#CONFIG_SUNXI_DMA=y

#SPI
CONFIG_SPI=y
CONFIG_SUNXI_SPI=y
CONFIG_SPI_FLASH=y
CONFIG_SPI_FLASH_WINBOND=y
CONFIG_SPI_FLASH_EON=y
CONFIG_SPI_FLASH_GIGADEVICE=y
CONFIG_SPI_FLASH_ISSI=y
CONFIG_SPI_FLASH_MACRONIX=y
CONFIG_SPI_FLASH_SPANSION=y
CONFIG_SPI_FLASH_ATMEL=y
CONFIG_SPI_FLASH_STMICRO=y
CONFIG_SPI_FLASH_SST=y
CONFIG_SPI_FLASH_PUYA=y
CONFIG_SPI_FLASH_FM=y
CONFIG_SPI_FLASH_XT=y

CONFIG_SPINOR_UBOOT_OFFSET=128
CONFIG_SPINOR_LOGICAL_OFFSET=2016

CONFIG_SF_DEFAULT_SPEED=50000000
# BIT(12) BIT(13) (SPI_RX_DUAL|SPI_RX_QUAD)
CONFIG_SF_DEFAULT_MODE=0x3000

# flash
CONFIG_SUNXI_FLASH=y
#CONFIG_SUNXI_NAND=y
CONFIG_SUNXI_SPINOR=y
CONFIG_SUNXI_NOR_IMG=y

#usb otg config
CONFIG_SUNXI_USB=y
CONFIG_SUNXI_EFEX=y
CONFIG_SUNXI_FASTBOOT=y
#partition
CONFIG_EFI_PARTITION=y


#image
CONFIG_ANDROID_BOOT_IMAGE=y

#sprite
CONFIG_SUNXI_SPRITE=y

#cmd
CONFIG_CMD_SUNXI_TIMER=y
CONFIG_CMD_SUNXI_SPRITE=y
CONFIG_CMD_SUNXI_EFEX=y
CONFIG_CMD_FASTBOOT=y
CONFIG_CMD_GPT=y
CONFIG_CMD_FAT=y
CONFIG_CMD_SUNXI_DMA=y
CONFIG_CMD_SF=y
CONFIG_CMD_SF_TEST=y
CONFIG_CMD_PART=y
```

## configs/sun8iw18p1_rtos_defconfig
```kconfig
CONFIG_ARM=y
CONFIG_ARCH_SUNXI=y
CONFIG_MACH_SUN8IW18=y
# CONFIG_AXP_GPIO=y
CONFIG_DEFAULT_DEVICE_TREE="sun8iw18p1-soc"
# CONFIG_SYS_MALLOC_CLEAR_ON_INIT is not set
CONFIG_CONSOLE_MUX=y
CONFIG_PRE_CONSOLE_BUFFER=n
#CONFIG_OF_BOARD=y
CONFIG_OF_SEPARATE=y
#CONFIG_SUNXI_REPLACE_FDT_FROM_PARTITION=y
CONFIG_SYS_TEXT_BASE=0x43000000
CONFIG_SUNXI_FDT_ADDR=0x41800000

#system
CONFIG_ARM_SMCCC=y
CONFIG_SUNXI_DMA=y
#CONFIG_SUNXI_SWITCH_SYSTEM is not set

#key
CONFIG_SUNXI_PHY_KEY=y
CONFIG_SUNXI_LRADC_KEY=y

#I2C
# CONFIG_SYS_I2C_SUNXI is not set
# CONFIG_SYS_SUNXI_I2C_SLAVE=0x50
# CONFIG_SYS_SUNXI_I2C_SPEED=400000
# CONFIG_I2C0_ENABLE is not set
# CONFIG_I2C1_ENABLE is not set

#SPI
CONFIG_SPI=y
CONFIG_SUNXI_SPI=y
CONFIG_SPI_USE_DMA=y
CONFIG_SPI_FLASH=y
CONFIG_SPI_FLASH_WINBOND=y
CONFIG_SPI_FLASH_EON=y
CONFIG_SPI_FLASH_GIGADEVICE=y
CONFIG_SPI_FLASH_ISSI=y
CONFIG_SPI_FLASH_MACRONIX=y
CONFIG_SPI_FLASH_SPANSION=y
CONFIG_SPI_FLASH_ATMEL=y
CONFIG_SPI_FLASH_STMICRO=y
CONFIG_SPI_FLASH_SST=y
CONFIG_SPI_FLASH_PUYA=y

CONFIG_SF_DEFAULT_SPEED=50000000
# BIT(12) BIT(13) (SPI_RX_DUAL|SPI_RX_QUAD)
CONFIG_SF_DEFAULT_MODE=0x3000

#
# PWM_SUNXI
#
# CONFIG_PWM_SUNXI is not set
CONFIG_PWM_SUNXI_NEW=y

CONFIG_SPINOR_UBOOT_OFFSET=128
CONFIG_SPINOR_LOGICAL_OFFSET=2016

# flash
CONFIG_SUNXI_FLASH=y
CONFIG_SUNXI_NAND=y
CONFIG_SUNXI_SPINOR=y
CONFIG_SUNXI_UBIFS=y

# env
#CONFIG_SUNXI_REDUNDAND_ENVIRONMENT=y
#CONFIG_ENV_SIZE=0x20000

#usb otg config
CONFIG_SUNXI_USB=y
CONFIG_SUNXI_EFEX=y
CONFIG_SUNXI_BURN=y
CONFIG_SUNXI_FASTBOOT=y
CONFIG_SUNXI_USB_DETECT=y
#partition
CONFIG_EFI_PARTITION=y

#image
CONFIG_ANDROID_BOOT_IMAGE=y

#sprite
CONFIG_SUNXI_SPRITE=y
CONFIG_SUNXI_SECURE_STORAGE=y
CONFIG_SUNXI_COMPARE_IMAGE_AND_FLASH=y

#secure feature
CONFIG_SUNXI_SECURE_BOOT=y
CONFIG_SUNXI_KEYBOX=y

#cmd
CONFIG_CMD_SUNXI_TIMER=y
CONFIG_CMD_SUNXI_SPRITE=y
CONFIG_CMD_SUNXI_EFEX=y
CONFIG_CMD_SUNXI_BURN=y
CONFIG_CMD_GPT=y
CONFIG_CMD_FAT=y
CONFIG_CMD_FASTBOOT=y
CONFIG_CMD_SUNXI_DMA=y
CONFIG_CMD_PART=y
CONFIG_CMD_SF=y
CONFIG_CMD_SF_TEST=y

#CONFIG_CMD_SUNXI_AUTO_FEL=y
CONFIG_SUNXI_SERIAL=y

#CONFIG_CMD_PWM_LED is not set

# GPIO
# ifdef this can change GPIO interrupt clock select
# Temporarily to modify the XR829 wifi interrupt sampling rate
CONFIG_SUNXI_GPIO_INT_DEB=y

# freeetos
CONFIG_SUNXI_FREERTOS=y
CONFIG_SUNXI_FREERTOS_OFFSET1=1024
CONFIG_SUNXI_FREERTOS_OFFSET2=5120
CONFIG_SUNXI_FREERTOS_LOGICAL_OFFSET=10208
```

## configs/sun8iw18p1_ubifs_defconfig
```kconfig
CONFIG_ARM=y
CONFIG_ARCH_SUNXI=y
CONFIG_MACH_SUN8IW18=y
# CONFIG_AXP_GPIO=y
CONFIG_DEFAULT_DEVICE_TREE="sun8iw18-common"
# CONFIG_SYS_MALLOC_CLEAR_ON_INIT is not set
CONFIG_CONSOLE_MUX=y
CONFIG_PRE_CONSOLE_BUFFER=n
CONFIG_OF_BOARD=y
CONFIG_SYS_TEXT_BASE=0x43000000
CONFIG_SUNXI_FDT_ADDR=0x41800000

#system
CONFIG_ARM_SMCCC=y
CONFIG_SUNXI_DMA=y

#I2C
CONFIG_SYS_I2C_SUNXI=y
CONFIG_SYS_SUNXI_I2C_SLAVE=0x50
CONFIG_SYS_SUNXI_I2C_SPEED=400000
CONFIG_I2C0_ENABLE=y
CONFIG_I2C1_ENABLE=y


#
# PWM_SUNXI
#
# CONFIG_PWM_SUNXI is not set
CONFIG_PWM_SUNXI_NEW=y

CONFIG_SPINOR_UBOOT_OFFSET=128
CONFIG_SPINOR_LOGICAL_OFFSET=2016

# flash
CONFIG_SUNXI_FLASH=y
CONFIG_SUNXI_NAND=y
CONFIG_SUNXI_UBIFS=y

#usb otg config
CONFIG_SUNXI_USB=y
CONFIG_SUNXI_EFEX=y
CONFIG_SUNXI_BURN=y
CONFIG_SUNXI_FASTBOOT=y
#partition
CONFIG_EFI_PARTITION=y

#image
CONFIG_ANDROID_BOOT_IMAGE=y

#sprite
CONFIG_SUNXI_SPRITE=y
CONFIG_SUNXI_SECURE_STORAGE=y

#secure feature
CONFIG_SUNXI_SECURE_BOOT=y
CONFIG_SUNXI_KEYBOX=y

#cmd
CONFIG_CMD_SUNXI_TIMER=y
CONFIG_CMD_SUNXI_SPRITE=y
CONFIG_CMD_SUNXI_EFEX=y
CONFIG_CMD_SUNXI_BURN=y
CONFIG_CMD_GPT=y
CONFIG_CMD_FAT=y
CONFIG_CMD_FASTBOOT=y
CONFIG_CMD_SUNXI_DMA=y
CONFIG_CMD_PART=y

#CONFIG_SUNXI_SERIAL is not set
```

## configs/sun8iw19p1_defconfig
```kconfig
CONFIG_ARM=y
CONFIG_ARCH_SUNXI=y
CONFIG_MACH_SUN8IW19=y
#CONFIG_AXP_GPIO=y
CONFIG_DEFAULT_DEVICE_TREE="sun8iw19-common"
# CONFIG_SYS_MALLOC_CLEAR_ON_INIT is not set
CONFIG_CONSOLE_MUX=y
CONFIG_OF_BOARD=y
CONFIG_SYS_TEXT_BASE=0x4a000000

#device tree address for kernel
CONFIG_SUNXI_FDT_ADDR=0x41800000

#system
CONFIG_ARM_SMCCC=y
#CONFIG_SUNXI_DEBUG=y
CONFIG_SUNXI_DMA=y

#SPI
CONFIG_SPI=y
CONFIG_SUNXI_SPI=y
CONFIG_SPI_FLASH=y
CONFIG_SPI_FLASH_WINBOND=y
CONFIG_SPI_FLASH_EON=y
CONFIG_SPI_FLASH_GIGADEVICE=y
CONFIG_SPI_FLASH_ISSI=y
CONFIG_SPI_FLASH_MACRONIX=y
CONFIG_SPI_FLASH_SPANSION=y
CONFIG_SPI_FLASH_ATMEL=y
CONFIG_SPI_FLASH_STMICRO=y
CONFIG_SPI_FLASH_SST=y
CONFIG_SPI_FLASH_PUYA=y
CONFIG_SPI_FLASH_FM=y
CONFIG_SPI_FLASH_XT=y
CONFIG_SPI_FLASH_ADESTO=y
CONFIG_SPI_FLASH_XMC=y

CONFIG_SPINOR_UBOOT_OFFSET=128
CONFIG_SPINOR_LOGICAL_OFFSET=2016
# BIT(12) BIT(13) (SPI_RX_DUAL|SPI_RX_QUAD)
CONFIG_SF_DEFAULT_MODE=0x3000
CONFIG_SF_DEFAULT_SPEED=50000000
#I2C
CONFIG_SYS_I2C_SUNXI=y
CONFIG_SYS_SUNXI_R_I2C0_SLAVE=0x34
CONFIG_SYS_SUNXI_R_I2C0_SPEED=400000
CONFIG_R_I2C0_ENABLE=y

#power
CONFIG_SUNXI_POWER=y
CONFIG_SUNXI_PMU=y
CONFIG_SUNXI_BMU=y
CONFIG_SUNXI_TRY_POWER_SPLY=y
CONFIG_AXP2101_POWER=y
#CONFIG_AXPNULL_POWER=y
CONFIG_SUNXI_AXP152_POWER=y
CONFIG_AXP152_SUNXI_I2C_SLAVE=0x30

# flash
CONFIG_SUNXI_FLASH=y
CONFIG_SUNXI_NAND=y
#CONFIG_SUNXI_UBIFS=y
CONFIG_SUNXI_COMM_NAND_V1=y
CONFIG_SUNXI_SDMMC=y
CONFIG_MMC=y
CONFIG_SUNXI_SPINOR=y

#usb otg config
CONFIG_SUNXI_USB=y
CONFIG_SUNXI_EFEX=y
CONFIG_SUNXI_FASTBOOT=y
#partition
CONFIG_EFI_PARTITION=y


#image
CONFIG_ANDROID_BOOT_IMAGE=y

#sprite
CONFIG_SUNXI_SPRITE=y
CONFIG_SUNXI_SPRITE_CARTOON=y

#cmd
CONFIG_CMD_SUNXI_TIMER=y
CONFIG_CMD_SUNXI_SPRITE=y
CONFIG_CMD_SUNXI_EFEX=y
CONFIG_CMD_FASTBOOT=y
CONFIG_CMD_GPT=y
CONFIG_CMD_FAT=y
CONFIG_CMD_SUNXI_DMA=y
CONFIG_CMD_SF=y
CONFIG_CMD_SF_TEST=y
CONFIG_CMD_PART=y

#adc
CONFIG_SUNXI_GPADC=y

#
# Clock
#
CONFIG_CLK_SUNXI=y
# PWM_SUNXI
#
CONFIG_PWM_SUNXI=y
# CONFIG_PWM_SUNXI_NEW is not set
#
# BOOT GUI
#
CONFIG_BOOT_GUI=y
# CONFIG_UPDATE_DISPLAY_MODE is not set
# CONFIG_CONFIG_LCD_CHECK_SKIP_OPEN is not set
# CONFIG_BOOT_GUI_DOUBLE_BUF is not set
# CONFIG_BOOT_GUI_TEST is not set

#
# SUNXI LOGO DISPLAY
#
CONFIG_CMD_SUNXI_BMP=y
CONFIG_DISP2_SUNXI=y

#
# LCD panels select
#
CONFIG_LCD_SUPPORT_ST7789V_CPU=y
CONFIG_LCD_SUPPORT_WTL096601G03=y
CONFIG_LCD_SUPPORT_ST7701S=y
```

## configs/sun8iw19p1_nor_min_defconfig
```kconfig
CONFIG_ARM=y
CONFIG_ARCH_SUNXI=y
CONFIG_MACH_SUN8IW19=y
#CONFIG_AXP_GPIO=y
CONFIG_DEFAULT_DEVICE_TREE="sun8iw19-common"
# CONFIG_SYS_MALLOC_CLEAR_ON_INIT is not set
CONFIG_CONSOLE_MUX=y
CONFIG_OF_BOARD=y
CONFIG_SYS_TEXT_BASE=0x4a000000

#device tree address for kernel
CONFIG_SUNXI_FDT_ADDR=0x41800000

#system
CONFIG_ARM_SMCCC=y
#CONFIG_SUNXI_DEBUG=y
CONFIG_SUNXI_DMA=y

#SPI
CONFIG_SPI=y
CONFIG_SUNXI_SPI=y
CONFIG_SPI_FLASH=y
CONFIG_SPI_FLASH_WINBOND=y
CONFIG_SPI_FLASH_EON=y
CONFIG_SPI_FLASH_GIGADEVICE=y
CONFIG_SPI_FLASH_ISSI=y
CONFIG_SPI_FLASH_MACRONIX=y
CONFIG_SPI_FLASH_SPANSION=y
CONFIG_SPI_FLASH_ATMEL=y
CONFIG_SPI_FLASH_STMICRO=y
CONFIG_SPI_FLASH_SST=y
CONFIG_SPI_FLASH_PUYA=y
CONFIG_SPI_FLASH_FM=y

CONFIG_SPINOR_UBOOT_OFFSET=128
CONFIG_SPINOR_LOGICAL_OFFSET=2016
# BIT(12) BIT(13) (SPI_RX_DUAL|SPI_RX_QUAD)
CONFIG_SF_DEFAULT_MODE=0x3000
CONFIG_SF_DEFAULT_SPEED=50000000

#I2C
#CONFIG_SYS_I2C_SUNXI=y
#CONFIG_SYS_SUNXI_R_I2C0_SLAVE=0x34
#CONFIG_SYS_SUNXI_R_I2C0_SPEED=400000
#CONFIG_R_I2C0_ENABLE=y

#power
#CONFIG_SUNXI_POWER=y
#CONFIG_SUNXI_PMU=y
#CONFIG_SUNXI_BMU=y
#CONFIG_AXP2101_POWER=y

# flash
CONFIG_SUNXI_FLASH=y
#CONFIG_SUNXI_NAND=y
CONFIG_SUNXI_SDMMC=n
CONFIG_MMC=n
CONFIG_SUNXI_SPINOR=y
CONFIG_SUNXI_NOR_IMG=y

#pwm
CONFIG_PWM_NOT_USE=y

#usb otg config
#CONFIG_SUNXI_USB=y
#CONFIG_SUNXI_EFEX=y
#CONFIG_SUNXI_FASTBOOT=y
#partition
CONFIG_EFI_PARTITION=y


#image
CONFIG_ANDROID_BOOT_IMAGE=y

#sprite
CONFIG_SUNXI_SPRITE=y
#CONFIG_SUNXI_SECURE_STORAGE=y
CONFIG_SUNXI_SPRITE_RECOVERY=n

#cmd
CONFIG_CMD_SUNXI_TIMER=n
CONFIG_CMD_SUNXI_SPRITE=n
CONFIG_CMD_SUNXI_EFEX=n
CONFIG_CMD_FASTBOOT=n
CONFIG_CMD_GPT=n
CONFIG_CMD_FAT=n
CONFIG_CMD_SUNXI_DMA=n
CONFIG_CMD_SF=n
CONFIG_CMD_SF_TEST=n
CONFIG_CMD_PART=n
CONFIG_CMD_BDI=n
CONFIG_CMD_CONSOLE=n
CONFIG_CMD_GO=n
CONFIG_CMD_EXPORTENV=n
CONFIG_CMD_IMPORTENV=n
CONFIG_CMD_EDITENV=n
CONFIG_CMD_ENV_EXISTS=n
CONFIG_CMD_CRC32=n
CONFIG_CMD_MEMORY=n
CONFIG_CMD_FLASH=n
CONFIG_CMD_LOADB=n
CONFIG_CMD_LOADS=n
CONFIG_CMD_ECHO=n
CONFIG_CMD_ITEST=n
CONFIG_CMD_SOURCE=n
CONFIG_CMD_SETEXPR=n
CONFIG_CMD_MISC=n

#uboot shell
CONFIG_CMDLINE_EDITING=n
CONFIG_AUTO_COMPLETE=n
CONFIG_SYS_LONGHELP=n

# SUNXI LOGO DISPLAY
#CONFIG_SUNXI_SPINOR_BMP=y
#

#net
CONFIG_NET=n

#info
CONFIG_DISPLAY_CPUINFO=n
CONFIG_DISPLAY_BOARDINFO=n
```

## configs/sun8iw19p1_rtos_nor_defconfig
```kconfig
CONFIG_ARM=y
CONFIG_ARCH_SUNXI=y
CONFIG_MACH_SUN8IW19=y
#CONFIG_AXP_GPIO=y
CONFIG_DEFAULT_DEVICE_TREE="sun8iw19-common"
# CONFIG_SYS_MALLOC_CLEAR_ON_INIT is not set
CONFIG_CONSOLE_MUX=y
CONFIG_OF_BOARD=y
CONFIG_SYS_TEXT_BASE=0x4a000000

#device tree address for kernel
CONFIG_SUNXI_FDT_ADDR=0x41800000

#system
CONFIG_ARM_SMCCC=y
#CONFIG_SUNXI_DEBUG=y
CONFIG_SUNXI_DMA=y

#SPI
CONFIG_SPI=y
CONFIG_SUNXI_SPI=y
CONFIG_SPI_USE_DMA=y
CONFIG_SPI_FLASH=y
CONFIG_SPI_FLASH_WINBOND=y
CONFIG_SPI_FLASH_EON=y
CONFIG_SPI_FLASH_GIGADEVICE=y
CONFIG_SPI_FLASH_ISSI=y
CONFIG_SPI_FLASH_MACRONIX=y
CONFIG_SPI_FLASH_SPANSION=y
CONFIG_SPI_FLASH_ATMEL=y
CONFIG_SPI_FLASH_STMICRO=y
CONFIG_SPI_FLASH_SST=y
CONFIG_SPI_FLASH_PUYA=y
CONFIG_SPI_FLASH_FM=y
CONFIG_SPI_FLASH_XT=y
CONFIG_SPI_FLASH_ADESTO=y
CONFIG_SPI_FLASH_XMC=y

CONFIG_SF_DEFAULT_SPEED=50000000
# BIT(12) BIT(13) (SPI_RX_DUAL|SPI_RX_QUAD)
CONFIG_SF_DEFAULT_MODE=0x3000
CONFIG_SPINOR_UBOOT_OFFSET=128
CONFIG_SPINOR_LOGICAL_OFFSET=2016

#I2C
CONFIG_SYS_I2C_SUNXI=y
CONFIG_SYS_SUNXI_R_I2C0_SLAVE=0x34
CONFIG_SYS_SUNXI_R_I2C0_SPEED=400000
CONFIG_R_I2C0_ENABLE=y

#geth
CONFIG_NETDEVICES=y
CONFIG_SUNXI_GETH=y

CONFIG_NET=y
CONFIG_NET_RANDOM_ETHADDR=y

CONFIG_CMD_TFTPBOOT=y
CONFIG_NET_TFTP_VARS=y
CONFIG_CMD_NFS=y
CONFIG_CMD_PING=y

#power
CONFIG_SUNXI_POWER=y
CONFIG_SUNXI_PMU=y
CONFIG_SUNXI_BMU=y
CONFIG_SUNXI_TRY_POWER_SPLY=y
CONFIG_AXP2101_POWER=y
#CONFIG_AXPNULL_POWER=y
CONFIG_SUNXI_AXP152_POWER=y
CONFIG_AXP152_SUNXI_I2C_SLAVE=0x30


# flash
CONFIG_SUNXI_FLASH=y
#CONFIG_SUNXI_NAND=y
CONFIG_SUNXI_SDMMC=y
CONFIG_MMC=y
CONFIG_SUNXI_SPINOR=y
CONFIG_SUNXI_NOR_IMG=y

#usb otg config
CONFIG_SUNXI_USB=y
CONFIG_SUNXI_EFEX=y
#CONFIG_SUNXI_BURN=y
CONFIG_SUNXI_FASTBOOT=y
#partition
CONFIG_EFI_PARTITION=y


#image
CONFIG_ANDROID_BOOT_IMAGE=y

#sprite
CONFIG_SUNXI_SPRITE=y

#cmd
CONFIG_CMD_SUNXI_TIMER=y
CONFIG_CMD_SUNXI_SPRITE=y
CONFIG_CMD_SUNXI_EFEX=y
CONFIG_CMD_SUNXI_BURN=y
CONFIG_CMD_FASTBOOT=y
CONFIG_CMD_GPT=y
CONFIG_CMD_FAT=y
CONFIG_CMD_SUNXI_DMA=y
CONFIG_CMD_SF=y
CONFIG_CMD_SF_TEST=y
CONFIG_CMD_PART=y

CONFIG_SUNXI_ARM_SOFT_FP=y
CONFIG_USE_PRIVATE_LIBGCC=y

# SUNXI LOGO DISPLAY
CONFIG_SUNXI_SPINOR_BMP=y
CONFIG_SUNXI_SPINOR_JPEG=y

#adc
CONFIG_SUNXI_GPADC=y
```
